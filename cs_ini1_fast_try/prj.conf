## CMakeLists.txt
```
#
# Copyright (c) 2024 Nordic Semiconductor
#
# SPDX-License-Identifier: LicenseRef-Nordic-5-Clause
#
set(CMAKE_EXPORT_COMPILE_COMMANDS ON)
cmake_minimum_required(VERSION 3.20.0)

find_package(Zephyr REQUIRED HINTS $ENV{ZEPHYR_BASE})
project(cs_ini1)

FILE(GLOB app_sources src/*.c)
# NORDIC SDK APP START
target_sources(app PRIVATE
	${app_sources}
)
# NORDIC SDK APP END
```

## prj.conf
```kconfig
#
# Copyright (c) 2024 Nordic Semiconductor ASA
#
# SPDX-License-Identifier: LicenseRef-Nordic-5-Clause
#

CONFIG_NCS_SAMPLES_DEFAULTS=y
CONFIG_DK_LIBRARY=y

CONFIG_BT=y
CONFIG_BT_SMP=y
CONFIG_BT_CENTRAL=y
CONFIG_BT_MAX_CONN=1
CONFIG_BT_BONDABLE=n

CONFIG_BT_GATT_CLIENT=y
CONFIG_BT_GATT_DYNAMIC_DB=y

CONFIG_BT_CHANNEL_SOUNDING=y
CONFIG_BT_RAS=y
CONFIG_BT_RAS_RREQ=y

CONFIG_BT_SCAN=y
CONFIG_BT_SCAN_FILTER_ENABLE=y
CONFIG_BT_SCAN_UUID_CNT=1

# The Ranging Profile recommends a MTU of at least 247 octets.
CONFIG_BT_L2CAP_TX_MTU=498
CONFIG_BT_BUF_ACL_TX_SIZE=502
CONFIG_BT_BUF_ACL_RX_SIZE=502
CONFIG_BT_ATT_PREPARE_COUNT=3
CONFIG_BT_CTLR_DATA_LENGTH_MAX=251

# This allows CS and ACL to use different PHYs
CONFIG_BT_TRANSMIT_POWER_CONTROL=y

# This improves the performance of floating-point operations
CONFIG_FPU=y
CONFIG_FPU_SHARING=y

CONFIG_CBPRINTF_FP_SUPPORT=y

CONFIG_LOG=y
CONFIG_LOG_DEFAULT_LEVEL=3
CONFIG_LOG_MODE_DEFERRED=y
CONFIG_LOG_BACKEND_UART=y
CONFIG_LOG_BUFFER_SIZE=65536     
# 甚至更大
CONFIG_LOG_PROCESS_TRIGGER_THRESHOLD=256
CONFIG_LOG_PRINTK=y
```

## src/main.c
```c
/*
 * Copyright (c) 2024 Nordic Semiconductor ASA
 *
 * SPDX-License-Identifier: LicenseRef-Nordic-5-Clause
 */

/** @file
 *  @brief Channel Sounding Initiator with Ranging Requestor sample
 */

#include "distance_estimation.h"
#include <bluetooth/gatt_dm.h>
#include <bluetooth/scan.h>
#include <bluetooth/services/ras.h>
#include <zephyr/bluetooth/conn.h>
#include <zephyr/bluetooth/cs.h>
#include <zephyr/bluetooth/gatt.h>
#include <zephyr/kernel.h>
#include <zephyr/types.h>

#include <dk_buttons_and_leds.h>

#include <zephyr/logging/log.h>
LOG_MODULE_REGISTER(app_main, LOG_LEVEL_INF);

#define CON_STATUS_LED DK_LED1

#define CS_CONFIG_ID 0
#define NUM_MODE_0_STEPS 3
#define PROCEDURE_COUNTER_NONE (-1)

#define LOCAL_PROCEDURE_MEM                                                    \
  ((BT_RAS_MAX_STEPS_PER_PROCEDURE * sizeof(struct bt_le_cs_subevent_step)) +  \
   (BT_RAS_MAX_STEPS_PER_PROCEDURE * BT_RAS_MAX_STEP_DATA_LEN))

static K_SEM_DEFINE(sem_remote_capabilities_obtained, 0, 1);
static K_SEM_DEFINE(sem_config_created, 0, 1);
static K_SEM_DEFINE(sem_cs_security_enabled, 0, 1);
static K_SEM_DEFINE(sem_procedure_done, 0, 1);
static K_SEM_DEFINE(sem_connected, 0, 1);
static K_SEM_DEFINE(sem_rd_ready, 0, 1);
static K_SEM_DEFINE(sem_discovery_done, 0, 1);
static K_SEM_DEFINE(sem_mtu_exchange_done, 0, 1);
static K_SEM_DEFINE(sem_rd_complete, 0, 1);
static K_SEM_DEFINE(sem_security, 0, 1);

static struct bt_conn *connection;
static uint8_t n_ap;
NET_BUF_SIMPLE_DEFINE_STATIC(latest_local_steps, LOCAL_PROCEDURE_MEM);
NET_BUF_SIMPLE_DEFINE_STATIC(latest_peer_steps, BT_RAS_PROCEDURE_MEM);
static int32_t most_recent_peer_ranging_counter = PROCEDURE_COUNTER_NONE;
static int32_t most_recent_local_ranging_counter = PROCEDURE_COUNTER_NONE;
static int32_t dropped_ranging_counter = PROCEDURE_COUNTER_NONE;
static bool distance_estimation_in_progress;

// 什么是子事件回调？
// 如果正在进行距离估算，则丢弃新数据。
// 检查子事件是否完成，或者是否被中止。
// 如果子事件成功完成，将数据存储到 latest_local_steps 缓冲区中。
static void subevent_result_cb(struct bt_conn *conn,
                               struct bt_conn_le_cs_subevent_result *result) {
  LOG_INF("Subevent result callback %d", result->header.procedure_counter);

  if (distance_estimation_in_progress) {
    LOG_WRN(
        "New procedure data received whilst estimating previous distance, drop "
        "this procedure.");
    dropped_ranging_counter = result->header.procedure_counter;
    return;
  }

  if (result->header.subevent_done_status == BT_CONN_LE_CS_SUBEVENT_ABORTED) {
    /* If this subevent was aborted, drop the entire procedure for now. */
    LOG_WRN("Subevent aborted");
    dropped_ranging_counter = result->header.procedure_counter;
    net_buf_simple_reset(&latest_local_steps);
    return;
  }

  if (dropped_ranging_counter == result->header.procedure_counter) {
    return;
  }

  if (result->step_data_buf) {
    if (result->step_data_buf->len <=
        net_buf_simple_tailroom(&latest_local_steps)) {
      uint16_t len = result->step_data_buf->len;
      uint8_t *step_data = net_buf_simple_pull_mem(result->step_data_buf, len);

      net_buf_simple_add_mem(&latest_local_steps, step_data, len);
    } else {
      LOG_ERR("Not enough memory to store step data. (%d > %d)",
              latest_local_steps.len + result->step_data_buf->len,
              latest_local_steps.size);
      net_buf_simple_reset(&latest_local_steps);
      dropped_ranging_counter = result->header.procedure_counter;
      return;
    }
  }

  dropped_ranging_counter = PROCEDURE_COUNTER_NONE;
  n_ap = result->header.num_antenna_paths;

  if (result->header.procedure_done_status ==
      BT_CONN_LE_CS_PROCEDURE_COMPLETE) {
    most_recent_local_ranging_counter = result->header.procedure_counter;
    distance_estimation_in_progress = true;
    k_sem_give(&sem_procedure_done);
  } else if (result->header.procedure_done_status ==
             BT_CONN_LE_CS_PROCEDURE_ABORTED) {
    LOG_WRN("Procedure aborted");
    net_buf_simple_reset(&latest_local_steps);
  }
}

// 当测距数据获取完成时触发
static void ranging_data_get_complete_cb(struct bt_conn *conn,
                                         uint16_t ranging_counter, int err) {
  ARG_UNUSED(conn);

  if (err) {
    LOG_ERR("Error when getting ranging data with ranging counter %d (err %d)",
            ranging_counter, err);
    return;
  }

  LOG_INF("Ranging data get completed for ranging counter %d", ranging_counter);
  k_sem_give(&sem_rd_complete);
}

// 当对端设备的测距数据准备好时触发
static void ranging_data_ready_cb(struct bt_conn *conn,
                                  uint16_t ranging_counter) {
  LOG_INF("Ranging data ready %i", ranging_counter);
  most_recent_peer_ranging_counter = ranging_counter;
  k_sem_give(&sem_rd_ready);
}

// 当对端设备的测距数据被覆盖时触发
static void ranging_data_overwritten_cb(struct bt_conn *conn,
                                        uint16_t ranging_counter) {
  LOG_INF("Ranging data overwritten %i", ranging_counter);
}

// 当MTU交换成功时触发
static void mtu_exchange_cb(struct bt_conn *conn, uint8_t err,
                            struct bt_gatt_exchange_params *params) {
  if (err) {
    LOG_ERR("MTU exchange failed (err %d)", err);
    return;
  }

  LOG_INF("MTU exchange success (%u)", bt_gatt_get_mtu(conn));
  k_sem_give(&sem_mtu_exchange_done);
}

// 当发现服务成功时触发，服务发现成功，初始化探测服务的句柄
static void discovery_completed_cb(struct bt_gatt_dm *dm, void *context) {
  int err;

  LOG_INF("The discovery procedure succeeded");

  struct bt_conn *conn = bt_gatt_dm_conn_get(dm);

  bt_gatt_dm_data_print(dm);

  err = bt_ras_rreq_alloc_and_assign_handles(dm, conn);
  if (err) {
    LOG_ERR("RAS RREQ alloc init failed (err %d)", err);
  }

  err = bt_gatt_dm_data_release(dm);
  if (err) {
    LOG_ERR("Could not release the discovery data (err %d)", err);
  }

  k_sem_give(&sem_discovery_done);
}

// 当发现服务失败时触发，如果服务未找到，断开连接
static void discovery_service_not_found_cb(struct bt_conn *conn,
                                           void *context) {
  LOG_INF("The service could not be found during the discovery, disconnecting");
  bt_conn_disconnect(connection, BT_HCI_ERR_REMOTE_USER_TERM_CONN);
}

// 当发现服务失败时触发，如果服务未找到，断开连接
static void discovery_error_found_cb(struct bt_conn *conn, int err,
                                     void *context) {
  LOG_INF("The discovery procedure failed (err %d)", err);
  bt_conn_disconnect(connection, BT_HCI_ERR_REMOTE_USER_TERM_CONN);
}

static struct bt_gatt_dm_cb discovery_cb = {
    .completed = discovery_completed_cb,
    .service_not_found = discovery_service_not_found_cb,
    .error_found = discovery_error_found_cb,
};

// 当安全状态改变时触发，当蓝牙安全级别变化时触发
static void security_changed(struct bt_conn *conn, bt_security_t level,
                             enum bt_security_err err) {
  char addr[BT_ADDR_LE_STR_LEN];

  bt_addr_le_to_str(bt_conn_get_dst(conn), addr, sizeof(addr));

  if (err) {
    LOG_ERR("Security failed: %s level %u err %d %s", addr, level, err,
            bt_security_err_to_str(err));
    return;
  }

  LOG_INF("Security changed: %s level %u", addr, level);
  k_sem_give(&sem_security);
}

static bool le_param_req(struct bt_conn *conn, struct bt_le_conn_param *param) {
  /* Ignore peer parameter preferences. */
  return false;
}

// 处理设备连接成功事件，点亮 LED 并更新连接状态。
static void connected_cb(struct bt_conn *conn, uint8_t err) {
  char addr[BT_ADDR_LE_STR_LEN];

  (void)bt_addr_le_to_str(bt_conn_get_dst(conn), addr, sizeof(addr));
  LOG_INF("Connected to %s (err 0x%02X)", addr, err);

  if (err) {
    bt_conn_unref(conn);
    connection = NULL;
  }

  connection = bt_conn_ref(conn);

  k_sem_give(&sem_connected);

  dk_set_led_on(CON_STATUS_LED);
}

// 处理设备断开连接事件，熄灭 LED 并更新连接状态。
static void disconnected_cb(struct bt_conn *conn, uint8_t reason) {
  LOG_INF("Disconnected (reason 0x%02X)", reason);

  bt_conn_unref(conn);
  connection = NULL;
  dk_set_led_off(CON_STATUS_LED);
}

static void remote_capabilities_cb(struct bt_conn *conn,
                                   struct bt_conn_le_cs_capabilities *params) {
  ARG_UNUSED(params);
  LOG_INF("CS capability exchange completed.");
  k_sem_give(&sem_remote_capabilities_obtained);
}

static void config_created_cb(struct bt_conn *conn,
                              struct bt_conn_le_cs_config *config) {
  LOG_INF("CS config creation complete. ID: %d", config->id);
  k_sem_give(&sem_config_created);
}

static void security_enabled_cb(struct bt_conn *conn) {
  LOG_INF("CS security enabled.");
  k_sem_give(&sem_cs_security_enabled);
}

static void
procedure_enabled_cb(struct bt_conn *conn,
                     struct bt_conn_le_cs_procedure_enable_complete *params) {
  if (params->state == 1) {
    LOG_INF("CS procedures enabled.");
  } else {
    LOG_INF("CS procedures disabled.");
  }
}

static void scan_filter_match(struct bt_scan_device_info *device_info,
                              struct bt_scan_filter_match *filter_match,
                              bool connectable) {
  char addr[BT_ADDR_LE_STR_LEN];

  bt_addr_le_to_str(device_info->recv_info->addr, addr, sizeof(addr));

  LOG_INF("Filters matched. Address: %s connectable: %d", addr, connectable);
}

static void scan_connecting_error(struct bt_scan_device_info *device_info) {
  int err;

  LOG_INF("Connecting failed, restarting scanning");

  err = bt_scan_start(BT_SCAN_TYPE_SCAN_PASSIVE);
  if (err) {
    LOG_ERR("Failed to restart scanning (err %i)", err);
    return;
  }
}

static void scan_connecting(struct bt_scan_device_info *device_info,
                            struct bt_conn *conn) {
  LOG_INF("Connecting");
}

BT_SCAN_CB_INIT(scan_cb, scan_filter_match, NULL, scan_connecting_error,
                scan_connecting);

// 初始化扫描参数，添加服务过滤器。
// 启用扫描过滤器以寻找支持信道探测的设备。
static int scan_init(void) {
  int err;

  struct bt_scan_init_param param = {.scan_param = NULL,
                                     .conn_param = BT_LE_CONN_PARAM_DEFAULT,
                                     .connect_if_match = 1};

  bt_scan_init(&param);
  bt_scan_cb_register(&scan_cb);

  err = bt_scan_filter_add(BT_SCAN_FILTER_TYPE_UUID, BT_UUID_RANGING_SERVICE);
  if (err) {
    LOG_ERR("Scanning filters cannot be set (err %d)", err);
    return err;
  }

  err = bt_scan_filter_enable(BT_SCAN_UUID_FILTER, false);
  if (err) {
    LOG_ERR("Filters cannot be turned on (err %d)", err);
    return err;
  }

  return 0;
}

BT_CONN_CB_DEFINE(conn_cb) = {
    .connected = connected_cb,
    .disconnected = disconnected_cb,
    .le_param_req = le_param_req,
    .security_changed = security_changed,
    .le_cs_remote_capabilities_available = remote_capabilities_cb,
    .le_cs_config_created = config_created_cb,
    .le_cs_security_enabled = security_enabled_cb,
    .le_cs_procedure_enabled = procedure_enabled_cb,
    .le_cs_subevent_data_available = subevent_result_cb,
};

static void set_custom_channel_map(uint8_t channel_map[10]) {
  // 初始化所有信道为无效（全 0）
  memset(channel_map, 0x00, 10);

  // 定义启用的信道集合。例如：启用信道 2、3、10、11
  uint8_t valid_channels[] = {2,  5,  8,  11, 14, 17, 20, 23, 26, 29, 32,
                              35, 38, 41, 44, 47, 50};
  // uint8_t valid_channels[] = {2, 2, 2, 2, 2, 2, 2, 2, 2, 2, 2, 2, 2, 2, 2, 2};

  // 遍历启用的信道集合，将对应 bit 设置为有效
  for (size_t i = 0; i < sizeof(valid_channels) / sizeof(valid_channels[0]);
       i++) {
    uint8_t channel = valid_channels[i];

    // 检查信道是否在有效范围
    if (channel > 78) {
      printk("Invalid channel: %d\n", channel);
      continue;
    }

    // 设置信道为有效
    channel_map[channel / 8] |= (1 << (channel % 8));
  }

  // 如果有协议限制（如禁用信道
  // 0、1、23、24、25、77、78），可以额外禁用这些信道
  channel_map[0] &= ~((1 << 0) | (1 << 1));            // 禁用信道 0 和 1
  channel_map[2] &= ~((1 << 7) | (1 << 6) | (1 << 5)); // 禁用信道 23、24、25
  channel_map[9] &= ~((1 << 5) | (1 << 6));            // 禁用信道 77、78
}

int main(void) {
  int err;

  LOG_INF("Starting Channel Sounding Initiator Sample");

  dk_leds_init();

  err = bt_enable(NULL);
  if (err) {
    LOG_ERR("Bluetooth init failed (err %d)", err);
    return 0;
  }

  err = scan_init();
  if (err) {
    LOG_ERR("Scan init failed (err %d)", err);
    return 0;
  }

  err = bt_scan_start(BT_SCAN_TYPE_SCAN_PASSIVE);
  if (err) {
    LOG_ERR("Scanning failed to start (err %i)", err);
    return 0;
  }

  k_sem_take(&sem_connected, K_FOREVER);

  err = bt_conn_set_security(connection, BT_SECURITY_L2);
  if (err) {
    LOG_ERR("Failed to encrypt connection (err %d)", err);
    return 0;
  }

  k_sem_take(&sem_security, K_FOREVER);

  static struct bt_gatt_exchange_params mtu_exchange_params = {
      .func = mtu_exchange_cb};

  bt_gatt_exchange_mtu(connection, &mtu_exchange_params);

  k_sem_take(&sem_mtu_exchange_done, K_FOREVER);

  err = bt_gatt_dm_start(connection, BT_UUID_RANGING_SERVICE, &discovery_cb,
                         NULL);
  if (err) {
    LOG_ERR("Discovery failed (err %d)", err);
    return 0;
  }

  k_sem_take(&sem_discovery_done, K_FOREVER);

  const struct bt_le_cs_set_default_settings_param default_settings = {
      .enable_initiator_role = true,
      .enable_reflector_role = false,
      .cs_sync_antenna_selection = BT_LE_CS_ANTENNA_SELECTION_OPT_REPETITIVE,
      .max_tx_power = BT_HCI_OP_LE_CS_MAX_MAX_TX_POWER,
  };

  err = bt_le_cs_set_default_settings(connection, &default_settings);
  if (err) {
    LOG_ERR("Failed to configure default CS settings (err %d)", err);
    return 0;
  }

  err = bt_ras_rreq_rd_overwritten_subscribe(connection,
                                             ranging_data_overwritten_cb);
  if (err) {
    LOG_ERR("RAS RREQ ranging data overwritten subscribe failed (err %d)", err);
    return 0;
  }

  err = bt_ras_rreq_rd_ready_subscribe(connection, ranging_data_ready_cb);
  if (err) {
    LOG_ERR("RAS RREQ ranging data ready subscribe failed (err %d)", err);
    return 0;
  }

  err = bt_ras_rreq_on_demand_rd_subscribe(connection);
  if (err) {
    LOG_ERR("RAS RREQ On-demand ranging data subscribe failed (err %d)", err);
    return 0;
  }

  err = bt_ras_rreq_cp_subscribe(connection);
  if (err) {
    LOG_ERR("RAS RREQ CP subscribe failed (err %d)", err);
    return 0;
  }

  err = bt_le_cs_read_remote_supported_capabilities(connection);
  if (err) {
    LOG_ERR("Failed to exchange CS capabilities (err %d)", err);
    return 0;
  }

  k_sem_take(&sem_remote_capabilities_obtained, K_FOREVER);

  struct bt_le_cs_create_config_params config_params = {
      .id = CS_CONFIG_ID,
      .main_mode_type = BT_CONN_LE_CS_MAIN_MODE_2,
      .sub_mode_type = BT_CONN_LE_CS_SUB_MODE_UNUSED,
      .min_main_mode_steps = 5,
      .max_main_mode_steps = 10,
      .main_mode_repetition = 0,
      .mode_0_steps = NUM_MODE_0_STEPS,
      .role = BT_CONN_LE_CS_ROLE_INITIATOR,
      .rtt_type = BT_CONN_LE_CS_RTT_TYPE_AA_ONLY,
      .cs_sync_phy = BT_CONN_LE_CS_SYNC_2M_PHY,
      .channel_map_repetition = 1,
      .channel_selection_type = BT_CONN_LE_CS_CHSEL_TYPE_3B,
      .ch3c_shape = BT_CONN_LE_CS_CH3C_SHAPE_HAT,
      .ch3c_jump = 1,
  };

  bt_le_cs_set_valid_chmap_bits(config_params.channel_map);

  // 在这个函数内部修改使用的通道
  set_custom_channel_map(config_params.channel_map);

  // 创建信道探测配置，指定探测模式、步数、天线配置等
  err = bt_le_cs_create_config(connection, &config_params,
                               BT_LE_CS_CREATE_CONFIG_CONTEXT_LOCAL_AND_REMOTE);
  if (err) {
    LOG_ERR("Failed to create CS config (err %d)", err);
    return 0;
  }

  k_sem_take(&sem_config_created, K_FOREVER);

  err = bt_le_cs_security_enable(connection);
  if (err) {
    LOG_ERR("Failed to start CS Security (err %d)", err);
    return 0;
  }

  k_sem_take(&sem_cs_security_enabled, K_FOREVER);

  const struct bt_le_cs_set_procedure_parameters_param procedure_params = {
      .config_id = CS_CONFIG_ID,
      .max_procedure_len = 100,
      .min_procedure_interval = 10,//do not larger than 5 until new data collected method is enbaled.
      .max_procedure_interval = 10,
      .max_procedure_count = 0,
      .min_subevent_len = 20000,
      .max_subevent_len = 40000,
      .tone_antenna_config_selection =
          BT_LE_CS_TONE_ANTENNA_CONFIGURATION_INDEX_ONE,
      .phy = BT_LE_CS_PROCEDURE_PHY_1M,
      .tx_power_delta = 0x80,
      .preferred_peer_antenna = BT_LE_CS_PROCEDURE_PREFERRED_PEER_ANTENNA_1,
      .snr_control_initiator = BT_LE_CS_INITIATOR_SNR_CONTROL_NOT_USED,
      .snr_control_reflector = BT_LE_CS_REFLECTOR_SNR_CONTROL_NOT_USED,
  };

  // 设置信道探测的具体参数，例如信号传输功率、物理层（PHY）等
  err = bt_le_cs_set_procedure_parameters(connection, &procedure_params);
  if (err) {
    LOG_ERR("Failed to set procedure parameters (err %d)", err);
    return 0;
  }

  struct bt_le_cs_procedure_enable_param params = {
      .config_id = CS_CONFIG_ID,
      .enable = 1,
  };

  err = bt_le_cs_procedure_enable(connection, &params);
  if (err) {
    LOG_ERR("Failed to enable CS procedures (err %d)", err);
    return 0;
  }

  // 主循环和距离估算
  while (true) {
    // 等待测距数据准备
    k_sem_take(&sem_procedure_done, K_FOREVER);
    distance_estimation_in_progress = true;

    // 检查对端和本地的测距计数器是否匹配
    err = k_sem_take(&sem_rd_ready, K_SECONDS(1));
    if (err) {
      LOG_WRN("Timeout waiting for ranging data ready (err %d)", err);
      goto retry;
    }

    if (most_recent_peer_ranging_counter != most_recent_local_ranging_counter) {
      LOG_WRN("Mismatch of local and peer ranging counters (%d != %d)",
              most_recent_peer_ranging_counter,
              most_recent_local_ranging_counter);
      goto retry;
    }

    // 获取对端设备的测距数据
    err = bt_ras_rreq_cp_get_ranging_data(connection, &latest_peer_steps,
                                          most_recent_peer_ranging_counter,
                                          ranging_data_get_complete_cb);
    if (err) {
      LOG_ERR("Get ranging data failed (err %d)", err);
      goto retry;
    }

    // 等待测距数据获取完成
    err = k_sem_take(&sem_rd_complete, K_SECONDS(5));
    if (err) {
      LOG_ERR("Timeout waiting for ranging data complete (err %d)", err);
      goto retry;
    }

    // 调用距离估算函数
    estimate_distance(&latest_local_steps, &latest_peer_steps, n_ap,
                      BT_CONN_LE_CS_ROLE_INITIATOR);

  retry:
    net_buf_simple_reset(&latest_local_steps);
    net_buf_simple_reset(&latest_peer_steps);
    distance_estimation_in_progress = false;
  }

  return 0;
}
```

## src/distance_estimation.c
```c
/*
 * Copyright (c) 2024 Nordic Semiconductor ASA
 *
 * SPDX-License-Identifier: LicenseRef-Nordic-5-Clause
 */

/** @file
 *  @brief Channel Sounding distance estimation for Ranging Requestor
 */

#include "zephyr/bluetooth/hci_types.h"
#include <bluetooth/services/ras.h>
#include <math.h>
#include <zephyr/bluetooth/cs.h>

#include <zephyr/logging/log.h>
LOG_MODULE_DECLARE(app_main, LOG_LEVEL_INF);

#define CS_FREQUENCY_MHZ(ch) (2402u + 1u * (ch))
#define CS_FREQUENCY_HZ(ch) (CS_FREQUENCY_MHZ(ch) * 1000000.0f)
#define SPEED_OF_LIGHT_M_PER_S (299792458.0f)
#define SPEED_OF_LIGHT_NM_PER_S (SPEED_OF_LIGHT_M_PER_S / 1000000000.0f)
#define PI 3.14159265358979323846f
#define MAX_NUM_RTT_SAMPLES 256
#define MAX_NUM_IQ_SAMPLES 256 * CONFIG_BT_RAS_MAX_ANTENNA_PATHS

// 包含每个信道的 IQ 数据和信道信息,
// 具体地说，这是每一个cs包的内容，一次探测只能在一个通道上进行。在多少个通道上采集了，就有多少个这样的样本
struct iq_sample_and_channel {
  bool failed;                               // 是否采样失败
  uint8_t channel;                           // 信道
  uint8_t antenna_permutation;               // 天线排列
  struct bt_le_cs_iq_sample local_iq_sample; // 本地 IQ 采样
  struct bt_le_cs_iq_sample peer_iq_sample;  // 对端 IQ 采样
};

struct rtt_timing {
  bool failed;
  int16_t toa_tod_initiator;
  int16_t tod_toa_reflector;
};

static struct iq_sample_and_channel iq_sample_channel_data[MAX_NUM_IQ_SAMPLES];
static struct rtt_timing rtt_timing_data[MAX_NUM_RTT_SAMPLES];

struct processing_context {
  uint16_t rtt_timing_data_index;
  uint16_t iq_sample_channel_data_index;
  uint8_t n_ap;
  enum bt_conn_le_cs_role role;
};

static void calc_complex_product(int32_t z_a_real, int32_t z_a_imag,
                                 int32_t z_b_real, int32_t z_b_imag,
                                 int32_t *z_out_real, int32_t *z_out_imag) {
  *z_out_real = z_a_real * z_b_real - z_a_imag * z_b_imag;
  *z_out_imag = z_a_real * z_b_imag + z_a_imag * z_b_real;
}

static float linear_regression(float *x_values, float *y_values,
                               uint8_t n_samples) {
  if (n_samples == 0) {
    return 0.0;
  }

  /* Estimates b in y = a + b x */

  float y_mean = 0.0;
  float x_mean = 0.0;

  for (uint8_t i = 0; i < n_samples; i++) {
    y_mean += (y_values[i] - y_mean) / (i + 1);
    x_mean += (x_values[i] - x_mean) / (i + 1);
  }

  float b_est_upper = 0.0;
  float b_est_lower = 0.0;

  for (uint8_t i = 0; i < n_samples; i++) {
    b_est_upper += (x_values[i] - x_mean) * (y_values[i] - y_mean);
    b_est_lower += (x_values[i] - x_mean) * (x_values[i] - x_mean);
  }

  return b_est_upper / b_est_lower;
}

static void bubblesort_2(float *array1, float *array2, uint16_t len) {
  bool swapped;
  float temp;

  for (uint16_t i = 0; i < len - 1; i++) {
    swapped = false;
    for (uint16_t j = 0; j < len - i - 1; j++) {
      if (array1[j] > array1[j + 1]) {
        temp = array1[j];
        array1[j] = array1[j + 1];
        array1[j + 1] = temp;
        temp = array2[j];
        array2[j] = array2[j + 1];
        array2[j + 1] = temp;
        swapped = true;
      }
    }

    if (!swapped) {
      break;
    }
  }
}

static float
estimate_distance_using_phase_slope(struct iq_sample_and_channel *data,
                                    uint8_t len) {
  int32_t combined_i;
  int32_t combined_q;
  uint16_t num_angles = 0;
  static float theta[MAX_NUM_IQ_SAMPLES];
  static float frequencies[MAX_NUM_IQ_SAMPLES];
  for (uint8_t i = 0; i < len; i++) {
    if (!data[i].failed) {
      // 计算 IQ 数据的复数乘积
      calc_complex_product(data[i].local_iq_sample.i, data[i].local_iq_sample.q,
                           data[i].peer_iq_sample.i, data[i].peer_iq_sample.q,
                           &combined_i, &combined_q);

      // 计算相位角,这就是反三角函数吧
      theta[num_angles] = atan2(1.0 * combined_q, 1.0 * combined_i);

      // 计算频率
      frequencies[num_angles] = 1.0 * CS_FREQUENCY_MHZ(data[i].channel);

      num_angles++;
    }
  }

  // 如果采样点不足，无法计算距离
  if (num_angles < 2) {
    return 0.0;
  }

  // 按频率对相位排序
  bubblesort_2(frequencies, theta, num_angles);

  /* One-dimensional phase unwrapping */
  // 相位展开（Phase Unwrapping）
  // 遍历所有相位角，确保相位值在 −π 到 π 范围内连续。
  for (uint8_t i = 1; i < num_angles; i++) {
    float difference = theta[i] - theta[i - 1];
    // 如果相邻相位角的差值大于 π，则将后续相位值减去 2π
    if (difference > PI) {
      for (uint8_t j = i; j < num_angles; j++) {
        theta[j] -= 2.0f * PI;
      }
    } else if (difference < -PI) {
      // 如果相邻相位角的差值小于 -π，则将后续相位值加上 2π
      for (uint8_t j = i; j < num_angles; j++) {
        theta[j] += 2.0f * PI;
      }
    }
  }

      // 输出相位展开后的信道和相位
    LOG_INF("Unwrapped Data -> Channel : Theta");
    for (uint8_t i = 0; i < num_angles; i++) {
        uint8_t channel = (uint8_t)(frequencies[i] - 2402); // 从频率计算信道编号
        LOG_INF("ch[%d] : %f radians", channel, (double)theta[i]);
    }

  // 使用线性回归计算相位斜率
  float phase_slope = linear_regression(frequencies, theta, num_angles);

  // 根据相位斜率计算距离
  float distance = -phase_slope * (SPEED_OF_LIGHT_M_PER_S / (4 * PI));

  return distance / 1000000.0f; /* Scale to meters. */
}

static float
estimate_distance_using_phase_slope_fast(struct iq_sample_and_channel *data,
                                    uint8_t len) {
  int32_t combined_i;
  int32_t combined_q;
  uint16_t num_angles = 0;
  static float theta[MAX_NUM_IQ_SAMPLES];
  static float frequencies[MAX_NUM_IQ_SAMPLES];

    for (uint8_t i = 0; i < len; i++) {
        // 打印基本信息
        printk("id:%d, f:%d, ch:%u, ap:%u, ", i, data[i].failed, data[i].channel, data[i].antenna_permutation);
        // 打印local IQ
        printk("li:%d, lq:%d, ", data[i].local_iq_sample.i, data[i].local_iq_sample.q);
        // 打印peer IQ
        printk("pi:%d, pq:%d\n", data[i].peer_iq_sample.i, data[i].peer_iq_sample.q);
    }

  for (uint8_t i = 0; i < len; i++) {
    if (!data[i].failed) {
      // 计算 IQ 数据的复数乘积
      calc_complex_product(data[i].local_iq_sample.i, data[i].local_iq_sample.q,
                           data[i].peer_iq_sample.i, data[i].peer_iq_sample.q,
                           &combined_i, &combined_q);

      // 计算相位角,这就是反三角函数吧
      theta[num_angles] = atan2(1.0 * combined_q, 1.0 * combined_i);

      // 计算频率
      frequencies[num_angles] = 1.0 * CS_FREQUENCY_MHZ(data[i].channel);

      num_angles++;
    }
  }

  // 如果采样点不足，无法计算距离
  // if (num_angles < 2) {
  //   return 0.0;
  // }

  // 按频率对相位排序
  // bubblesort_2(frequencies, theta, num_angles);

  /* One-dimensional phase unwrapping */
  // 相位展开（Phase Unwrapping）
  // 遍历所有相位角，确保相位值在 −π 到 π 范围内连续。
  // for (uint8_t i = 1; i < num_angles; i++) {
  //   float difference = theta[i] - theta[i - 1];
  //   // 如果相邻相位角的差值大于 π，则将后续相位值减去 2π
  //   if (difference > PI) {
  //     for (uint8_t j = i; j < num_angles; j++) {
  //       theta[j] -= 2.0f * PI;
  //     }
  //   } else if (difference < -PI) {
  //     // 如果相邻相位角的差值小于 -π，则将后续相位值加上 2π
  //     for (uint8_t j = i; j < num_angles; j++) {
  //       theta[j] += 2.0f * PI;
  //     }
  //   }
  // }

      // 输出相位展开后的信道和相位
    // LOG_INF("Unwrapped Data -> Channel : Theta");
    // for (uint8_t i = 0; i < num_angles; i++) {
    //     uint8_t channel = (uint8_t)(frequencies[i] - 2402); // 从频率计算信道编号
    //     LOG_INF("ch[%d] : %f radians", channel, (double)theta[i]);
    // }

  // 使用线性回归计算相位斜率
  // float phase_slope = linear_regression(frequencies, theta, num_angles);

  // 根据相位斜率计算距离
  // float distance = -phase_slope * (SPEED_OF_LIGHT_M_PER_S / (4 * PI));

  return 100000 / 1000000.0f; /* Scale to meters. */
}

static float estimate_distance_using_time_of_flight(uint8_t n_samples) {
  float tof;
  float tof_mean = 0.0;

  /* Cumulative Moving Average */
  for (uint8_t i = 0; i < n_samples; i++) {
    if (!rtt_timing_data[i].failed) {
      tof = (rtt_timing_data[i].toa_tod_initiator -
             rtt_timing_data[i].tod_toa_reflector) /
            2;
      tof_mean += (tof - tof_mean) / (i + 1);
    }
  }

  float tof_mean_ns = tof_mean / 2.0f;

  return tof_mean_ns * SPEED_OF_LIGHT_NM_PER_S;
}

// 将解析出的IQ样本数据存储到iq_sample_channel_data数组
// context - 处理上下文，包含处理过程中的各种索引和参数
// local_tone_info[] - 本地设备的音调信息数组
// peer_tone_info[] - 对端设备的音调信息数组
// channel - 当前处理的蓝牙信道
// antenna_permutation_index - 天线排列索引
static void process_tone_info_data(
    struct processing_context *context,
    struct bt_hci_le_cs_step_data_tone_info local_tone_info[],
    struct bt_hci_le_cs_step_data_tone_info peer_tone_info[], uint8_t channel,
    uint8_t antenna_permutation_index) {

  // 循环处理每个天线路径
  for (uint8_t i = 0; i < (context->n_ap + 1); i++) {
    // 如果本地或对端的音调信息扩展指示符不是BT_HCI_LE_CS_NOT_TONE_EXT_SLOT，则跳过
    if (local_tone_info[i].extension_indicator !=
            BT_HCI_LE_CS_NOT_TONE_EXT_SLOT ||
        peer_tone_info[i].extension_indicator !=
            BT_HCI_LE_CS_NOT_TONE_EXT_SLOT) {
      continue;
    }

    if (context->iq_sample_channel_data_index >= MAX_NUM_IQ_SAMPLES) {
      LOG_WRN("More IQ samples than size of iq_sample_channel_data array");
      return;
    }

    // 将当前处理的信道和天线排列索引存储到IQ样本数据中
    iq_sample_channel_data[context->iq_sample_channel_data_index].channel =
        channel;
    iq_sample_channel_data[context->iq_sample_channel_data_index]
        .antenna_permutation = antenna_permutation_index;

    // 解析并存储IQ样本,使用bt_le_cs_parse_pct函数解析本地和对端的相位校正项（phase
    // correction term），得到IQ样本数据
    iq_sample_channel_data[context->iq_sample_channel_data_index]
        .local_iq_sample =
        bt_le_cs_parse_pct(local_tone_info[i].phase_correction_term);
    iq_sample_channel_data[context->iq_sample_channel_data_index]
        .peer_iq_sample =
        bt_le_cs_parse_pct(peer_tone_info[i].phase_correction_term);
    // 似乎是判断接收信号的质量的,如果本地或对端的音调质量指示器显示为低质量或不可用，则将该IQ样本标记为失败。
    if (local_tone_info[i].quality_indicator == BT_HCI_LE_CS_TONE_QUALITY_LOW ||
        local_tone_info[i].quality_indicator ==
            BT_HCI_LE_CS_TONE_QUALITY_UNAVAILABLE ||
        peer_tone_info[i].quality_indicator == BT_HCI_LE_CS_TONE_QUALITY_LOW ||
        peer_tone_info[i].quality_indicator ==
            BT_HCI_LE_CS_TONE_QUALITY_UNAVAILABLE) {
      iq_sample_channel_data[context->iq_sample_channel_data_index].failed =
          true;
    }

    context->iq_sample_channel_data_index++;
  }
}

static void
process_rtt_timing_data(struct processing_context *context,
                        struct bt_hci_le_cs_step_data_mode_1 *local_rtt_data,
                        struct bt_hci_le_cs_step_data_mode_1 *peer_rtt_data) {
  if (context->rtt_timing_data_index >= MAX_NUM_RTT_SAMPLES) {
    LOG_WRN("More RTT samples processed than size of rtt_timing_data array");
    return;
  }

  if (local_rtt_data->packet_quality_aa_check !=
          BT_HCI_LE_CS_PACKET_QUALITY_AA_CHECK_SUCCESSFUL ||
      local_rtt_data->packet_rssi == BT_HCI_LE_CS_PACKET_RSSI_NOT_AVAILABLE ||
      local_rtt_data->tod_toa_reflector ==
          BT_HCI_LE_CS_TIME_DIFFERENCE_NOT_AVAILABLE ||
      peer_rtt_data->packet_quality_aa_check !=
          BT_HCI_LE_CS_PACKET_QUALITY_AA_CHECK_SUCCESSFUL ||
      peer_rtt_data->packet_rssi == BT_HCI_LE_CS_PACKET_RSSI_NOT_AVAILABLE ||
      peer_rtt_data->tod_toa_reflector ==
          BT_HCI_LE_CS_TIME_DIFFERENCE_NOT_AVAILABLE) {
    rtt_timing_data[context->rtt_timing_data_index].failed = true;
  }

  if (context->role == BT_CONN_LE_CS_ROLE_INITIATOR) {
    rtt_timing_data[context->rtt_timing_data_index].toa_tod_initiator =
        local_rtt_data->toa_tod_initiator;
    rtt_timing_data[context->rtt_timing_data_index].tod_toa_reflector =
        peer_rtt_data->tod_toa_reflector;
  } else if (context->role == BT_CONN_LE_CS_ROLE_REFLECTOR) {
    rtt_timing_data[context->rtt_timing_data_index].tod_toa_reflector =
        local_rtt_data->tod_toa_reflector;
    rtt_timing_data[context->rtt_timing_data_index].toa_tod_initiator =
        peer_rtt_data->toa_tod_initiator;
  }

  context->rtt_timing_data_index++;
}

static bool process_step_data(struct bt_le_cs_subevent_step *local_step,
                              struct bt_le_cs_subevent_step *peer_step,
                              void *user_data) {
  struct processing_context *context = (struct processing_context *)user_data;

  if (local_step->mode == BT_CONN_LE_CS_MAIN_MODE_2) {
    struct bt_hci_le_cs_step_data_mode_2 *local_step_data =
        (struct bt_hci_le_cs_step_data_mode_2 *)local_step->data;
    struct bt_hci_le_cs_step_data_mode_2 *peer_step_data =
        (struct bt_hci_le_cs_step_data_mode_2 *)peer_step->data;

    process_tone_info_data(context, local_step_data->tone_info,
                           peer_step_data->tone_info, local_step->channel,
                           local_step_data->antenna_permutation_index);

  } else if (local_step->mode == BT_HCI_OP_LE_CS_MAIN_MODE_1) {
    struct bt_hci_le_cs_step_data_mode_1 *local_step_data =
        (struct bt_hci_le_cs_step_data_mode_1 *)local_step->data;
    struct bt_hci_le_cs_step_data_mode_1 *peer_step_data =
        (struct bt_hci_le_cs_step_data_mode_1 *)peer_step->data;

    process_rtt_timing_data(context, local_step_data, peer_step_data);

  } else if (local_step->mode == BT_HCI_OP_LE_CS_MAIN_MODE_3) {
    struct bt_hci_le_cs_step_data_mode_3 *local_step_data =
        (struct bt_hci_le_cs_step_data_mode_3 *)local_step->data;
    struct bt_hci_le_cs_step_data_mode_3 *peer_step_data =
        (struct bt_hci_le_cs_step_data_mode_3 *)peer_step->data;

    process_rtt_timing_data(
        context, (struct bt_hci_le_cs_step_data_mode_1 *)local_step_data,
        (struct bt_hci_le_cs_step_data_mode_1 *)peer_step_data);

    process_tone_info_data(context, local_step_data->tone_info,
                           peer_step_data->tone_info, local_step->channel,
                           local_step_data->antenna_permutation_index);
  }

  return true;
}

void estimate_distance(struct net_buf_simple *local_steps,
                       struct net_buf_simple *peer_steps, uint8_t n_ap,
                       enum bt_conn_le_cs_role role) {
  struct processing_context context = {
      .rtt_timing_data_index = 0,
      .iq_sample_channel_data_index = 0,
      .n_ap = n_ap,
      .role = role,
  };

  memset(rtt_timing_data, 0, sizeof(rtt_timing_data));
  memset(iq_sample_channel_data, 0, sizeof(iq_sample_channel_data));

  bt_ras_rreq_rd_subevent_data_parse(peer_steps, local_steps, context.role,
                                     NULL, process_step_data, &context);

  float phase_slope_based_distance = estimate_distance_using_phase_slope_fast(
      iq_sample_channel_data, context.iq_sample_channel_data_index);

  float rtt_based_distance =
      estimate_distance_using_time_of_flight(context.rtt_timing_data_index);

  if (rtt_based_distance == 0.0f && phase_slope_based_distance == 0.0f) {
    LOG_INF("A reliable distance estimate could not be computed.");
  } else {
    LOG_INF("Estimated distance to reflector:");
  }

  if (rtt_based_distance != 0.0f) {
    LOG_INF("- Round-Trip Timing method: %f meters (derived from %d samples)",
            (double)rtt_based_distance, context.rtt_timing_data_index);
  }
  if (phase_slope_based_distance != 0.0f) {
    LOG_INF("- Phase-Based Ranging method: %f meters (derived from %d samples)",
            (double)phase_slope_based_distance,
            context.iq_sample_channel_data_index);
  }
}
```
