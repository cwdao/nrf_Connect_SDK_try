## CMakeLists.txt
```
#
# Copyright (c) 2022 Nordic Semiconductor ASA
#
# SPDX-License-Identifier: LicenseRef-Nordic-5-Clause

cmake_minimum_required(VERSION 3.20.0)

find_package(Zephyr REQUIRED HINTS $ENV{ZEPHYR_BASE})

project(321df_central)

# NORDIC SDK APP START
target_sources(app PRIVATE
  src/main.c
  src/uart_cmd.c
)
# NORDIC SDK APP END
```

## prj.conf
```kconfig
#
# Copyright (c) 2022 Nordic Semiconductor ASA
#
# SPDX-License-Identifier: LicenseRef-Nordic-5-Clause
#

CONFIG_BT=y
CONFIG_LOG=y
CONFIG_BT_DEVICE_NAME="Direction Finding Central"

CONFIG_BT_CENTRAL=y
CONFIG_BT_SMP=y
CONFIG_BT_GATT_CLIENT=y

# Enable Direction Finding Feature RX in connected mode
CONFIG_BT_DF=y
CONFIG_BT_DF_CONNECTION_CTE_RX=y
CONFIG_BT_DF_CONNECTION_CTE_REQ=y

# maybe find how to enable 16 bits later
# CONFIG_BT_HCI_VS=y
# CONFIG_BT_DF_VS_CONN_IQ_REPORT_16_BITS_IQ_SAMPLES=y

CONFIG_BT_TRANSMIT_POWER_CONTROL=y
CONFIG_BT_CTLR_TX_PWR_PLUS_8=y
CONFIG_UART_INTERRUPT_DRIVEN=y
```

## boards/nrf5340dk_nrf5340_cpuapp.overlay
```dts
/*
 * Copyright (c) 2022 Nordic Semiconductor ASA
 *
 * SPDX-License-Identifier: LicenseRef-Nordic-5-Clause
 */

/* Enable pin forwarding to the network core. The selected pins will be used by
 * the Radio Direction Finding Extension for antenna switching purposes.
 *
 * Note: Pay attention to assigning the same GPIO pins as those provided in
 * the network core DTS overlay.
 */
&gpio_fwd {
	dfe-gpio-if {
		gpios = <&gpio0 4 0>,
			<&gpio0 5 0>,
			<&gpio0 6 0>,
			<&gpio0 7 0>;
		};
};

&uart0 {
	current-speed = <230400>;
};
```

## src/main.c
```c
/*
 * Copyright (c) 2022 Nordic Semiconductor ASA
 *
 * SPDX-License-Identifier: LicenseRef-Nordic-5-Clause
 */

#include <errno.h>
#include <zephyr/kernel.h>
#include <zephyr/sys/byteorder.h>
#include <zephyr/sys/printk.h>
#include <zephyr/types.h>

#include <zephyr/bluetooth/bluetooth.h>
#include <zephyr/bluetooth/conn.h>
#include <zephyr/bluetooth/direction.h>
#include <zephyr/bluetooth/hci.h>

#include <zephyr/bluetooth/hci_vs.h>
#include <zephyr/net_buf.h>

#include <string.h>
#include <stdlib.h>

#include "uart_cmd.h"

/* Latency set to zero, to enforce PDU exchange every connection event */
#define CONN_LATENCY 0U
/* Arbitrary selected timeout value */
#define CONN_TIMEOUT 400U

/* Default Inteval: 25ms => 20 * 1.25ms */
#define CONN_INT_DEFAULT_UNITS 0x08 /*0x08= 20, */

#define DF_FEAT_ENABLED BIT64(BT_LE_FEAT_BIT_CONN_CTE_RESP)

/* 协议帧版本 */
#define DF_VER 1
static uint32_t df_seq_num = 0;

static struct bt_conn *default_conn;

/* 连接参数改成可变：interval 由命令设置 */
static struct bt_le_conn_param g_conn_params =
    BT_LE_CONN_PARAM_INIT(CONN_INT_DEFAULT_UNITS,
                          CONN_INT_DEFAULT_UNITS,
                          CONN_LATENCY,
                          CONN_TIMEOUT);

/* ---------- CTE 参数：由命令设置---------- */
static uint8_t g_cte_len = 0x02; /* unit 8us */
static uint8_t g_cte_req_interval = 1U; /* connection events */
static uint8_t g_cte_type = BT_DF_CTE_TYPE_AOA;

/* CTE状态标志：跟踪CTE是否已启用 */
static bool g_cte_enabled = false;

/* 自定义信道列表（由命令设置） */
static uint8_t g_channels[10] = {3};
static size_t g_channel_cnt = 1;

#if defined(CONFIG_BT_DF_CTE_RX_AOA)
static const uint8_t ant_patterns[] = {0x2, 0x0, 0x5, 0x6, 0x1, 0x4,
                                       0xC, 0x9, 0xE, 0xD, 0x8, 0xA};
#endif /* CONFIG_BT_DF_CTE_RX_AOA */

static void start_scan(void);

/* 打印当前连接的发射功率 */
static void print_conn_tx_power(struct bt_conn *conn)
{
    int err;
    struct bt_conn_le_tx_power p = {0};

    p.phy = 0;
    err = bt_conn_le_get_tx_power_level(conn, &p);
    if (err) {
        printk("Read TX power failed (err %d)\n", err);
        return;
    }

    printk("TX power (conn): current=%d dBm, max=%d dBm\n",
           p.current_level, p.max_level);
}

static bool eir_found(struct bt_data *data, void *user_data)
{
    bt_addr_le_t *addr = user_data;
    uint64_t u64 = 0U;
    int err;

    switch (data->type) {
    case BT_DATA_LE_SUPPORTED_FEATURES:
        if (data->data_len > sizeof(u64)) {
            return true;
        }

        (void)memcpy(&u64, data->data, data->data_len);
        u64 = sys_le64_to_cpu(u64);

        if (!(u64 & DF_FEAT_ENABLED)) {
            return true;
        }

        err = bt_le_scan_stop();
        if (err) {
            printk("Stop LE scan failed (err %d)\n", err);
            return true;
        }

        err = bt_conn_le_create(addr, BT_CONN_LE_CREATE_CONN,
                                &g_conn_params, &default_conn);
        if (err) {
            printk("Create conn failed (err %d)\n", err);
            start_scan();
        }
        return false;
    }

    return true;
}

static void device_found(const bt_addr_le_t *addr, int8_t rssi, uint8_t type,
                         struct net_buf_simple *ad)
{
    ARG_UNUSED(rssi);

    /* We're only interested in connectable events */
    if (type == BT_GAP_ADV_TYPE_ADV_IND ||
        type == BT_GAP_ADV_TYPE_ADV_DIRECT_IND) {
        bt_data_parse(ad, eir_found, (void *)addr);
    }
}

/*  单信道是不合规的，至少需要双信道才合规。但我们只启用一个也能跑，看起来sdc没有限制。这和ble
 cs的14信道限制完全不同 */
static bool is_valid_data_channel(uint8_t ch)
{
    return (ch <= 36);
}

/* 根据自定义信道映射列表，发送HCI命令控制对方CTE的发包信道 */
int set_custom_channel_map_from_list(const uint8_t *channels,
                                     size_t channel_cnt)
{
    struct net_buf *buf;
    struct bt_hci_cp_le_set_host_chan_classif *cp;
    int err;
    size_t i;
    uint8_t valid_cnt = 0;

    if (!channels || channel_cnt == 0) {
        printk("Channel list empty\n");
        return -EINVAL;
    }

    buf = bt_hci_cmd_alloc(K_FOREVER);
    if (!buf) {
        printk("No HCI buffer\n");
        return -ENOMEM;
    }

    cp = net_buf_add(buf, sizeof(*cp));

    memset(cp->ch_map, 0x00, sizeof(cp->ch_map));

    for (i = 0; i < channel_cnt; i++) {
        uint8_t ch = channels[i];
        if (!is_valid_data_channel(ch)) {
            printk("Skip invalid/adv channel %u\n", ch);
            continue;
        }
        cp->ch_map[ch / 8] |= BIT(ch % 8);
        valid_cnt++;
    }

    err = bt_hci_cmd_send_sync(BT_HCI_OP_LE_SET_HOST_CHAN_CLASSIF, buf, NULL);
    if (err) {
        printk("Set channel map failed (err %d)\n", err);
        return err;
    }

    printk("Custom channel map applied (%u channels)\n", valid_cnt);
    return 0;
}

static void enable_cte_request(void)
{
    int err;

    const struct bt_df_conn_cte_rx_param cte_rx_params = {
#if defined(CONFIG_BT_DF_CTE_RX_AOA)
        .cte_types = BT_DF_CTE_TYPE_ALL,
        .slot_durations = BT_DF_ANTENNA_SWITCHING_SLOT_1US,
        .num_ant_ids = ARRAY_SIZE(ant_patterns),
        .ant_ids = ant_patterns,
#else
        .cte_types = BT_DF_CTE_TYPE_AOD_1US | BT_DF_CTE_TYPE_AOD_2US,
#endif
    };

    const struct bt_df_conn_cte_req_params cte_req_params = {
        .interval = g_cte_req_interval,
        .cte_length = g_cte_len,
        .cte_type = g_cte_type,
    };

    printk("Enable receiving of CTE...\n");
    err = bt_df_conn_cte_rx_enable(default_conn, &cte_rx_params);
    if (err) {
        printk("failed (err %d)\n", err);
        return;
    }
    printk("success. CTE receive enabled.\n");

    printk("Request CTE from peer device...\n");
    err = bt_df_conn_cte_req_enable(default_conn, &cte_req_params);
    if (err) {
        printk("failed (err %d)\n", err);
        g_cte_enabled = false;
        return;
    }
    printk("success. CTE request enabled.\n");
    g_cte_enabled = true;
}

static void disable_cte_request(void)
{
    if (!default_conn) {
        g_cte_enabled = false;
        return;
    }

    /* 不同 NCS/Zephyr 版本 disable API 名称可能不一致：
     * - bt_df_conn_cte_req_disable
     * - bt_df_conn_cte_rx_disable
     * 如果你编译报找不到符号，就注释对应行。
     */
#if defined(CONFIG_BT_DF_CONNECTION_CTE_RX)
    (void)bt_df_conn_cte_rx_disable(default_conn);
#endif
#if defined(CONFIG_BT_DF_CONNECTION_CTE_REQ)
    (void)bt_df_conn_cte_req_disable(default_conn);
#endif
    g_cte_enabled = false;
}

static void start_scan(void)
{
    int err;

    struct bt_le_scan_param scan_param = {
        .type = BT_LE_SCAN_TYPE_ACTIVE,
        .options = BT_LE_SCAN_OPT_NONE,
        .interval = BT_GAP_SCAN_FAST_INTERVAL,
        .window = BT_GAP_SCAN_FAST_WINDOW,
    };

    err = bt_le_scan_start(&scan_param, device_found);
    if (err) {
        printk("Scanning failed to start (err %d)\n", err);
        uart_cmd_send_evt("BLE", "scan_start_failed,err=%d", err);
        return;
    }

    printk("Scanning successfully started\n");
    uart_cmd_send_evt("BLE", "scan_started");
}

/* ---------- IQ report -> $DF 帧 ---------- */

static void sort_u16(uint16_t *a, size_t n)
{
    for (size_t i = 1; i < n; i++) {
        uint16_t key = a[i];
        size_t j = i;
        while (j > 0 && a[j - 1] > key) {
            a[j] = a[j - 1];
            j--;
        }
        a[j] = key;
    }
}

static void cte_recv_cb(struct bt_conn *conn,
                        struct bt_df_conn_iq_samples_report const *report)
{
    ARG_UNUSED(conn);

    if (!report || report->err != BT_DF_IQ_REPORT_ERR_SUCCESS) {
        return;
    }

    if (report->sample_type != BT_DF_IQ_SAMPLE_8_BITS_INT ||
        report->sample == NULL ||
        report->sample_count == 0) {
        return;
    }

    uint16_t p_array[8];
    int reference_sample_count = 8;

    if (report->sample_count < reference_sample_count) {
        return;
    }

    for (uint8_t n = 0; n < reference_sample_count; n++) {
        int32_t i = report->sample[n].i;
        int32_t q = report->sample[n].q;
        p_array[n] = (uint16_t)(i * i + q * q);
    }

    sort_u16(p_array, reference_sample_count);
    uint32_t sum_mid = 0;
    for (uint8_t k = 1; k <= 6; k++) {
        sum_mid += p_array[k];
    }
    uint32_t p_avg = sum_mid / 6;

    uint32_t ts_ms = k_uptime_get_32();

    printk("$DF,%u,%u,%u,%u,%u\r\n",
           DF_VER, report->chan_idx, df_seq_num++, ts_ms, p_avg);
}

/* ---------- BT callbacks ---------- */

static void connected(struct bt_conn *conn, uint8_t conn_err)
{
    char addr[BT_ADDR_LE_STR_LEN];
    bt_addr_le_to_str(bt_conn_get_dst(conn), addr, sizeof(addr));

    if (conn_err) {
        printk("Failed to connect to %s, 0x%02x %s\n",
               addr, conn_err, bt_hci_err_to_str(conn_err));

        uart_cmd_send_evt("BLE", "connect_failed,addr=%s,err=0x%02x", addr, conn_err);

        bt_conn_unref(default_conn);
        default_conn = NULL;

        start_scan();
        return;
    }

    printk("Connected: %s\n", addr);
    uart_cmd_send_evt("BLE", "connected,addr=%s", addr);

    /* Apply custom channel map */
    (void)set_custom_channel_map_from_list(g_channels, g_channel_cnt);

    /* 检查连接间隔参数 */
    int err;
    struct bt_conn_info info = {0};
    err = bt_conn_get_info(conn, &info);
    if (!err) {
        printk("Conn. interval is %u us\n", info.le.interval_us);
        uart_cmd_send_evt("BLE", "interval_us=%u", info.le.interval_us);
    }

    print_conn_tx_power(conn);

    if (conn == default_conn) {
        enable_cte_request();
        uart_cmd_send_evt("DF", "cte_enabled,len=%u,type=%u,intv=%u",
                          g_cte_len, g_cte_type, g_cte_req_interval);
    }
}

static void disconnected(struct bt_conn *conn, uint8_t reason)
{
    char addr[BT_ADDR_LE_STR_LEN];
    bt_addr_le_to_str(bt_conn_get_dst(conn), addr, sizeof(addr));

    printk("Disconnected: %s, reason 0x%02x %s\n",
           addr, reason, bt_hci_err_to_str(reason));
    uart_cmd_send_evt("BLE", "disconnected,addr=%s,reason=0x%02x", addr, reason);

    if (default_conn != conn) {
        return;
    }

    bt_conn_unref(default_conn);
    default_conn = NULL;
    g_cte_enabled = false;  /* 连接断开，重置CTE状态 */

    start_scan();
}

static void le_param_updated_cb(struct bt_conn *conn, uint16_t interval,
                                uint16_t latency, uint16_t timeout)
{
    ARG_UNUSED(conn);
    printk("LE param updated: interval %u *1.25(ms) latency %u timeout %u (ms)\n",
           interval, latency, timeout);

    uart_cmd_send_evt("BLE", "param_updated,interval_units=%u,lat=%u,to=%u",
                      interval, latency, timeout);
}

BT_CONN_CB_DEFINE(conn_callbacks) = {
    .connected = connected,
    .disconnected = disconnected,
    .cte_report_cb = cte_recv_cb,
    .le_param_updated = le_param_updated_cb,
};

/* ---------- 业务相关的解析辅助函数 ---------- */

/**
 * @brief 解析管道符分隔的信道列表字符串
 * 
 * 将格式为"3|10|25"的字符串解析为数组[3,10,25]
 * 
 * @param s 待解析的字符串（格式：数字|数字|数字...）
 * @param out 输出数组，存储解析出的信道号
 * @param out_cap out数组的容量
 * @param out_cnt 输出参数，存储实际解析出的信道数量
 * @return 0 成功，-EINVAL 参数无效，-ENOMEM 数组容量不足
 */
static int parse_channels(const char *s, uint8_t *out, size_t out_cap, size_t *out_cnt)
{
    if (!s || !out || !out_cnt) return -EINVAL;
    *out_cnt = 0;

    const char *p = s;
    while (*p) {
        char *end = NULL;
        unsigned long v = strtoul(p, &end, 10);
        if (end == p) return -EINVAL;  /* 无法解析数字 */
        if (v > 255) return -EINVAL;   /* 超出uint8_t范围 */

        if (*out_cnt >= out_cap) return -ENOMEM;
        out[(*out_cnt)++] = (uint8_t)v;

        if (*end == '\0') break;       /* 字符串结束 */
        if (*end != '|') return -EINVAL;  /* 分隔符必须是'|' */
        p = end + 1;  /* 移动到下一个数字 */
    }
    return 0;
}

/**
 * @brief 将毫秒间隔转换为BLE连接间隔单位（1.25ms units）
 * 
 * BLE连接间隔以1.25ms为单位，范围是7.5ms到4000ms
 * 转换公式：units = interval_ms * 100 / 125
 * 
 * @param interval_ms 毫秒间隔（必须是1.25ms的整数倍）
 * @param units 输出参数，存储转换后的单位数
 * @return 0 成功，-EINVAL 参数无效，-ERANGE 超出有效范围
 */
static int interval_ms_to_units(uint32_t interval_ms, uint16_t *units)
{
    if (!units) return -EINVAL;
    /* 用整数运算避免浮点：检查 interval_ms*100 是否能被125整除 */
    uint32_t x = interval_ms * 100U;
    if ((x % 125U) != 0U) return -EINVAL;  /* 不是1.25ms的整数倍 */

    uint32_t u = x / 125U;
    if (u < 6U || u > 3200U) return -ERANGE; /* BLE规范：7.5ms(6*1.25)..4s(3200*1.25) */
    *units = (uint16_t)u;
    return 0;
}

/**
 * @brief 命令处理主函数
 * 
 * 该函数由uart_cmd模块在解析到有效命令后调用
 * 支持的命令：
 * - PING: 心跳测试
 * - BLE_SCAN: 控制BLE扫描（start/stop）
 * - BLE_CONN: 控制BLE连接（disconnect）
 * - DF_START: 启动Direction Finding功能
 * - DF_CONFIG: 在DF运行时动态修改参数（不重新enable CTE REQ）
 * - DF_STOP: 停止Direction Finding功能
 * 
 * @param cmd 命令名称
 * @param argc 参数个数
 * @param argv 参数数组，格式可能是"key=value"或普通字符串
 */
static void on_cmd(const char *cmd, int argc, const char *argv[])
{
    /* PING命令：用于测试串口通信是否正常 */
    if (!strcmp(cmd, "PING")) {
        uart_cmd_send_ok("PING", "pong");
        return;
    }

    /* BLE_SCAN命令：控制BLE扫描 */
    if (!strcmp(cmd, "BLE_SCAN")) {
        const char *act = uart_cmd_kv_find(argc, argv, "action");
        if (!act) {
            uart_cmd_send_err("BLE_SCAN", 1, "MISSING_PARAM:action");
            return;
        }
        if (!strcmp(act, "start")) {
            start_scan();
            uart_cmd_send_ok("BLE_SCAN", "action=start");
            return;
        }
        if (!strcmp(act, "stop")) {
            int err = bt_le_scan_stop();
            if (err) {
                uart_cmd_send_err("BLE_SCAN", 2, "scan_stop_failed,err=%d", err);
            } else {
                uart_cmd_send_ok("BLE_SCAN", "action=stop");
                uart_cmd_send_evt("BLE", "scan_stopped");
            }
            return;
        }

        uart_cmd_send_err("BLE_SCAN", 3, "INVALID_PARAM:action");
        return;
    }

    /* BLE_CONN命令：控制BLE连接 */
    if (!strcmp(cmd, "BLE_CONN")) {
        const char *act = uart_cmd_kv_find(argc, argv, "action");
        if (!act) {
            uart_cmd_send_err("BLE_CONN", 1, "MISSING_PARAM:action");
            return;
        }
        if (!strcmp(act, "disconnect")) {
            if (!default_conn) {
                uart_cmd_send_err("BLE_CONN", 2, "NOT_CONNECTED");
                return;
            }
            int err = bt_conn_disconnect(default_conn, BT_HCI_ERR_REMOTE_USER_TERM_CONN);
            if (err) {
                uart_cmd_send_err("BLE_CONN", 3, "disconnect_failed,err=%d", err);
            } else {
                uart_cmd_send_ok("BLE_CONN", "action=disconnect");
            }
            return;
        }

        uart_cmd_send_err("BLE_CONN", 4, "INVALID_PARAM:action");
        return;
    }

    /* DF_START命令：启动Direction Finding功能
     * 参数（均为可选）：
     *   - channels: 信道列表，格式"3|10|25"（管道符分隔）
     *   - interval_ms: 连接间隔（毫秒，必须是1.25ms的整数倍）
     *   - cte_len: CTE长度（8us单位）
     *   - cte_type: CTE类型（"aod1"/"aod2"/"aoa"）
     */
    if (!strcmp(cmd, "DF_START")) {
        /* channels */
        const char *chs = uart_cmd_kv_find(argc, argv, "channels");
        if (chs) {
            size_t cnt = 0;
            uint8_t tmp[ARRAY_SIZE(g_channels)];
            int err = parse_channels(chs, tmp, ARRAY_SIZE(tmp), &cnt);
            if (err) {
                uart_cmd_send_err("DF_START", 1, "INVALID_PARAM:channels");
                return;
            }
            memcpy(g_channels, tmp, cnt);
            g_channel_cnt = cnt;
        }

        /* interval_ms */
        const char *ims = uart_cmd_kv_find(argc, argv, "interval_ms");
        if (ims) {
            uint32_t interval_ms = 0;
            uint16_t units = 0;
            if (uart_cmd_parse_u32(ims, &interval_ms) ||
                interval_ms_to_units(interval_ms, &units)) {
                uart_cmd_send_err("DF_START", 2, "INVALID_PARAM:interval_ms");
                return;
            }
            g_conn_params.interval_min = units;
            g_conn_params.interval_max = units;
        }

        /* cte_len (8us units) */
        const char *cl = uart_cmd_kv_find(argc, argv, "cte_len");
        if (cl) {
            uint8_t v = 0;
            if (uart_cmd_parse_u8(cl, &v)) {
                uart_cmd_send_err("DF_START", 3, "INVALID_PARAM:cte_len");
                return;
            }
            g_cte_len = v;
        }

        /* cte_type: aod1/aod2/aoa (若编译支持 AOA RX) */
        const char *ct = uart_cmd_kv_find(argc, argv, "cte_type");
        if (ct) {
            if (!strcmp(ct, "aod1")) g_cte_type = BT_DF_CTE_TYPE_AOD_1US;
            else if (!strcmp(ct, "aod2")) g_cte_type = BT_DF_CTE_TYPE_AOD_2US;
#if defined(CONFIG_BT_DF_CTE_RX_AOA)
            else if (!strcmp(ct, "aoa")) g_cte_type = BT_DF_CTE_TYPE_AOA;
#endif
            else {
                uart_cmd_send_err("DF_START", 4, "INVALID_PARAM:cte_type");
                return;
            }
        }

        uart_cmd_send_ok("DF_START",
                         "channels_cnt=%u,interval_units=%u,cte_len=%u,cte_type=%u",
                         (unsigned)g_channel_cnt,
                         (unsigned)g_conn_params.interval_min,
                         (unsigned)g_cte_len,
                         (unsigned)g_cte_type);

        /* 连接后会自动 enable_cte_request()（在 connected 回调里） */
        if (!default_conn) {
            start_scan();
            return;
        }

        /* 已连接：如果CTE已启用，先disable再enable（避免重复启用错误） */
        if (g_cte_enabled) {
            printk("CTE already enabled, disabling before re-enable...\n");
            disable_cte_request();
        }
        
        /* 应用新的信道映射 */
        (void)set_custom_channel_map_from_list(g_channels, g_channel_cnt);
        
        /* 重新启用CTE（使用新的参数） */
        enable_cte_request();
        return;
    }

    /**
     * @brief DF_CONFIG命令：在DF运行时动态修改参数（不重新enable CTE REQ）
     * 
     * 此命令用于在Direction Finding功能运行时动态修改配置参数，而不会中断CTE数据接收。
     * 与DF_START不同，DF_CONFIG不会重新enable CTE REQ，因此不会造成CTE接收的短暂中断。
     * 
     * 参数（均为可选）：
     *   - channels: 信道列表，格式"3|10|25"（管道符分隔）
     *     * 立即生效：直接更新信道映射，无需重新enable CTE REQ
     *   - interval_ms: 连接间隔（毫秒，必须是1.25ms的整数倍）
     *     * 下次连接生效：更新连接参数值，需要重新连接才能生效
     *   - cte_len: CTE长度（8us单位），范围0-255
     *     * 需要DF_START生效：只更新参数值，需要DF_START才能生效
     *   - cte_type: CTE类型（"aod1"/"aod2"/"aoa"）
     *     * 需要DF_START生效：只更新参数值，需要DF_START才能生效
     * 
     * 前置条件：
     *   - 必须已建立BLE连接（default_conn != NULL）
     *   - CTE必须已启用（g_cte_enabled == true）
     *   - 如果CTE未启用，请先使用DF_START命令
     * 
     * 使用场景：
     *   - 在DF运行时动态切换信道，不中断CTE数据接收
     *   - 更新参数值，等待下次使用DF_START时生效
     * 
     * @param cmd 命令名称（"DF_CONFIG"）
     * @param argc 参数个数
     * @param argv 参数数组
     */
    if (!strcmp(cmd, "DF_CONFIG")) {
        /* 检查是否已连接 */
        if (!default_conn) {
            uart_cmd_send_err("DF_CONFIG", 1, "NOT_CONNECTED");
            return;
        }

        /* 检查CTE是否已启用 */
        if (!g_cte_enabled) {
            uart_cmd_send_err("DF_CONFIG", 2, "CTE_NOT_ENABLED,use_DF_START_first");
            return;
        }

        /* channels - 可以直接更新，立即生效 */
        const char *chs = uart_cmd_kv_find(argc, argv, "channels");
        if (chs) {
            size_t cnt = 0;
            uint8_t tmp[ARRAY_SIZE(g_channels)];
            int err = parse_channels(chs, tmp, ARRAY_SIZE(tmp), &cnt);
            if (err) {
                uart_cmd_send_err("DF_CONFIG", 3, "INVALID_PARAM:channels");
                return;
            }
            memcpy(g_channels, tmp, cnt);
            g_channel_cnt = cnt;
        }

        /* interval_ms - 更新连接参数值（需要下次连接时生效） */
        const char *ims = uart_cmd_kv_find(argc, argv, "interval_ms");
        if (ims) {
            uint32_t interval_ms = 0;
            uint16_t units = 0;
            if (uart_cmd_parse_u32(ims, &interval_ms) ||
                interval_ms_to_units(interval_ms, &units)) {
                uart_cmd_send_err("DF_CONFIG", 4, "INVALID_PARAM:interval_ms");
                return;
            }
            g_conn_params.interval_min = units;
            g_conn_params.interval_max = units;
            printk("Note: interval_ms change will take effect on next connection\n");
        }

        /* cte_len (8us units) - 只更新参数值，需要DF_START才能生效 */
        const char *cl = uart_cmd_kv_find(argc, argv, "cte_len");
        if (cl) {
            uint8_t v = 0;
            if (uart_cmd_parse_u8(cl, &v)) {
                uart_cmd_send_err("DF_CONFIG", 5, "INVALID_PARAM:cte_len");
                return;
            }
            g_cte_len = v;
        }

        /* cte_type: aod1/aod2/aoa (若编译支持 AOA RX) - 只更新参数值，需要DF_START才能生效 */
        const char *ct = uart_cmd_kv_find(argc, argv, "cte_type");
        if (ct) {
            if (!strcmp(ct, "aod1")) g_cte_type = BT_DF_CTE_TYPE_AOD_1US;
            else if (!strcmp(ct, "aod2")) g_cte_type = BT_DF_CTE_TYPE_AOD_2US;
#if defined(CONFIG_BT_DF_CTE_RX_AOA)
            else if (!strcmp(ct, "aoa")) g_cte_type = BT_DF_CTE_TYPE_AOA;
#endif
            else {
                uart_cmd_send_err("DF_CONFIG", 6, "INVALID_PARAM:cte_type");
                return;
            }
        }

        /* 如果更新了信道映射，立即应用新的信道映射（不需要重新enable CTE REQ） */
        if (chs) {
            int err = set_custom_channel_map_from_list(g_channels, g_channel_cnt);
            if (err) {
                uart_cmd_send_err("DF_CONFIG", 7, "channel_map_update_failed,err=%d", err);
                return;
            }
        }

        /* 注意：
         * - channels: 已立即应用，无需重新enable CTE REQ
         * - interval_ms: 需要下次连接时生效
         * - cte_len/cte_type: 需要DF_START才能生效（会重新enable CTE REQ）
         */
        if (cl || ct) {
            printk("Note: cte_len/cte_type changes require DF_START to take effect\n");
        }

        uart_cmd_send_ok("DF_CONFIG",
                         "channels_cnt=%u,interval_units=%u,cte_len=%u,cte_type=%u",
                         (unsigned)g_channel_cnt,
                         (unsigned)g_conn_params.interval_min,
                         (unsigned)g_cte_len,
                         (unsigned)g_cte_type);
        return;
    }

    /* DF_STOP命令：停止Direction Finding功能 */
    if (!strcmp(cmd, "DF_STOP")) {
        disable_cte_request();
        uart_cmd_send_ok("DF_STOP", "done");
        return;
    }

    /* 未知命令 */
    uart_cmd_send_err(cmd, 99, "UNKNOWN_CMD");
}

/**
 * @brief 主函数
 * 
 * 系统初始化流程：
 * 1. 初始化串口命令接收系统（uart_cmd_init）
 * 2. 初始化蓝牙协议栈（bt_enable）
 * 3. 自动启动BLE扫描
 */
int main(void)
{
    int err;

    printk("BOOT: console up\r\n");

    /* 初始化串口命令接收系统，注册命令处理回调函数 */
    err = uart_cmd_init(on_cmd);
    if (err) {
        printk("uart_cmd_init failed (err %d)\n", err);
    }

    /* 初始化蓝牙协议栈 */
    err = bt_enable(NULL);
    if (err) {
        printk("Bluetooth init failed (err %d)\n", err);
        uart_cmd_send_evt("BLE", "bt_enable_failed,err=%d", err);
        return 0;
    }

    printk("Bluetooth initialized\n");
    uart_cmd_send_evt("BLE", "initialized");

    /* 默认自动扫描；你也可以改成等待 $CMD,BLE_SCAN,action=start */
    start_scan();

    return 0;
}
```

## src/uart_cmd.c
```c
#include "uart_cmd.h"

#include <zephyr/device.h>
#include <zephyr/devicetree.h>
#include <zephyr/drivers/uart.h>
#include <zephyr/kernel.h>
#include <zephyr/sys/printk.h>
#include <zephyr/sys/util.h>
#include <zephyr/sys/ring_buffer.h>

#include <stdarg.h>
#include <string.h>
#include <stdlib.h>
#include <errno.h>
#include <stdint.h>
#include <limits.h>

#define UART_DEV_NODE DT_CHOSEN(zephyr_console)

#define CMD_MAX_LINE     192
#define CMD_MAX_TOKENS   24

/* RX ring buffer：存原始字节流 */
#define RX_RING_SZ 512

/* 调试开关：1=打印每次解析到的整行 */
#define UART_CMD_DEBUG_LINE 1

static const struct device *g_uart;
static uart_cmd_handler_t g_handler;

K_THREAD_STACK_DEFINE(uart_cmd_stack, 1024);
static struct k_thread uart_cmd_tid;

static uint8_t rx_ring_mem[RX_RING_SZ];
static struct ring_buf rx_ring;
static struct k_sem rx_sem;

/**
 * @brief 检查字符串是否以指定前缀开头
 * @param s 待检查的字符串
 * @param pfx 前缀字符串
 * @return true 如果s以pfx开头，否则返回false
 */
static bool starts_with(const char *s, const char *pfx)
{
    return (strncmp(s, pfx, strlen(pfx)) == 0);
}

/**
 * @brief 将CSV格式字符串按逗号分割成多个token
 * 
 * 该函数会原地修改字符串s，将逗号替换为'\0'，并在out数组中存储每个token的起始地址
 * 例如："PING,key1=val1,key2=val2" 会被分割为：
 *   out[0] = "PING"
 *   out[1] = "key1=val1"
 *   out[2] = "key2=val2"
 * 
 * @param s 待分割的字符串（会被原地修改）
 * @param out 输出数组，存储每个token的指针
 * @param max_tokens out数组的最大容量
 * @return 实际分割出的token数量
 */
static int split_csv(char *s, const char *out[], int max_tokens)
{
    int n = 0;
    char *p = s;

    while (p && *p && n < max_tokens) {
        /* 跳过前导空白字符 */
        while (*p == ' ' || *p == '\t') {
            p++;
        }
        out[n++] = p;

        /* 查找下一个逗号 */
        char *comma = strchr(p, ',');
        if (!comma) {
            break;
        }
        /* 将逗号替换为字符串结束符 */
        *comma = '\0';
        p = comma + 1;
    }
    return n;
}

/**
 * @brief 处理一行完整的命令字符串
 * 
 * 命令格式：$CMD,<命令名>,<参数1>,<参数2>,...
 * 例如：$CMD,PING 或 $CMD,BLE_SCAN,action=start
 * 
 * 处理流程：
 * 1. 检查是否以"$CMD,"开头
 * 2. 提取命令体（去掉"$CMD,"前缀）
 * 3. 按逗号分割成多个token
 * 4. 第一个token作为命令名，其余作为参数
 * 5. 调用注册的命令处理函数
 * 
 * @param line 完整的命令行（以'\0'结尾）
 */
static void handle_line(char *line)
{
    /* 空行检查 */
    if (!line || !line[0]) {
        return;
    }

    /* 检查命令前缀：必须以"$CMD,"开头 */
    if (!starts_with(line, "$CMD,")) {
        return;
    }

    /* 提取命令体（跳过"$CMD,"这5个字符） */
    char *payload = line + 5;

    /* 分割命令体为多个token */
    const char *tokens[CMD_MAX_TOKENS];
    int ntok = split_csv(payload, tokens, CMD_MAX_TOKENS);

    /* 至少需要一个token（命令名） */
    if (ntok < 1) {
        uart_cmd_send_err("CMD", 1, "BAD_FORMAT");
        return;
    }

    /* 第一个token是命令名，其余是参数 */
    const char *cmd = tokens[0];
    const char **argv = &tokens[1];
    int argc = ntok - 1;

    /* 调用注册的命令处理函数 */
    if (g_handler) {
        g_handler(cmd, argc, argv);
    } else {
        uart_cmd_send_err(cmd, 2, "NO_HANDLER");
    }
}

/**
 * @brief UART接收中断回调函数
 * 
 * 该函数在UART接收到数据时被硬件中断调用，主要职责：
 * 1. 从UART硬件FIFO中读取接收到的字节
 * 2. 将字节数据放入ring buffer（环形缓冲区）
 * 3. 通过信号量唤醒命令解析线程
 * 
 * 注意：如果ring buffer已满，新数据会被丢弃，但仍会唤醒线程处理已有数据
 * 
 * @param dev UART设备指针
 * @param user_data 用户数据（未使用）
 */
static void uart_isr_cb(const struct device *dev, void *user_data)
{
    ARG_UNUSED(user_data);

    /* 检查并处理所有待处理的UART中断 */
    while (uart_irq_update(dev) && uart_irq_is_pending(dev)) {
        /* 检查是否有接收数据就绪 */
        if (uart_irq_rx_ready(dev)) {
            uint8_t buf[64];
            /* 从UART FIFO读取数据（最多64字节） */
            int r = uart_fifo_read(dev, buf, sizeof(buf));
            if (r > 0) {
                /* 将数据放入ring buffer（如果满了会丢弃部分数据） */
                uint32_t wrote = ring_buf_put(&rx_ring, buf, (uint32_t)r);
                (void)wrote;  /* 忽略实际写入的字节数 */
                /* 唤醒命令解析线程 */
                k_sem_give(&rx_sem);
            }
        }
    }
}

/**
 * @brief 串口命令解析线程主函数
 * 
 * 该线程负责：
 * 1. 从ring buffer中读取接收到的字节
 * 2. 按行组装命令（以'\n'为行结束符）
 * 3. 调用handle_line处理完整的命令行
 * 
 * 工作流程：
 * - 等待信号量（表示有数据到达）
 * - 从ring buffer逐个读取字节
 * - 忽略'\r'字符（回车符）
 * - 遇到'\n'时，将已积累的字符作为一行命令处理
 * - 如果行长度超过限制，丢弃该行并报错
 * 
 * @param a 线程参数1（未使用）
 * @param b 线程参数2（未使用）
 * @param c 线程参数3（未使用）
 */
static void uart_cmd_thread(void *a, void *b, void *c)
{
    ARG_UNUSED(a);
    ARG_UNUSED(b);
    ARG_UNUSED(c);

    char line[CMD_MAX_LINE];  /* 命令行缓冲区 */
    size_t len = 0;            /* 当前行已积累的字符数 */

    uart_cmd_send_evt("UART", "cmd_thread_started");

    while (1) {
        /* 等待信号量：表示有新的接收数据到达 */
        k_sem_take(&rx_sem, K_FOREVER);

        /* 从ring buffer中逐个读取字节 */
        uint8_t ch;
        while (ring_buf_get(&rx_ring, &ch, 1) == 1) {

            /* 忽略回车符（Windows换行是\r\n，Linux是\n） */
            if (ch == '\r') {
                continue;
            }

            /* 遇到换行符，表示一行命令结束 */
            if (ch == '\n') {
                if (len > 0) {
                    /* 添加字符串结束符 */
                    line[len] = '\0';
#if UART_CMD_DEBUG_LINE
                    printk("[LINE len=%u] '%s'\r\n", (unsigned)len, line);
#endif
                    /* 处理这一行命令 */
                    handle_line(line);
                    len = 0;  /* 重置行长度，准备接收下一行 */
                }
                continue;
            }

            /* 积累字符到行缓冲区 */
            if (len < (CMD_MAX_LINE - 1)) {
                line[len++] = (char)ch;
            } else {
                /* 行太长：丢弃本行直到下一个 '\n' */
                len = 0;
                uart_cmd_send_err("CMD", 3, "LINE_TOO_LONG");
            }
        }
    }
}

/**
 * @brief 初始化串口命令接收系统
 * 
 * 初始化步骤：
 * 1. 获取UART设备（从设备树中获取zephyr_console节点）
 * 2. 检查设备是否就绪
 * 3. 保存命令处理回调函数
 * 4. 初始化ring buffer和信号量
 * 5. 设置UART中断回调并启用接收中断
 * 6. 创建并启动命令解析线程
 * 
 * @param handler 命令处理回调函数
 * @return 0 成功，-ENODEV 设备不存在或未就绪
 */
int uart_cmd_init(uart_cmd_handler_t handler)
{
    /* 检查设备树中是否定义了UART设备节点 */
#if !DT_NODE_HAS_STATUS(UART_DEV_NODE, okay)
    return -ENODEV;
#endif

    /* 获取UART设备指针 */
    g_uart = DEVICE_DT_GET(UART_DEV_NODE);
    if (!device_is_ready(g_uart)) {
        return -ENODEV;
    }

    /* 保存命令处理回调函数 */
    g_handler = handler;

    /* 初始化ring buffer（用于存储接收到的原始字节流） */
    ring_buf_init(&rx_ring, sizeof(rx_ring_mem), rx_ring_mem);
    /* 初始化信号量（初始值为0，最大值为1） */
    k_sem_init(&rx_sem, 0, 1);

    /* 设置UART中断回调函数 */
    uart_irq_callback_set(g_uart, uart_isr_cb);
    /* 启用UART接收中断 */
    uart_irq_rx_enable(g_uart);

    /* 创建命令解析线程 */
    k_thread_create(&uart_cmd_tid, uart_cmd_stack,
                    K_THREAD_STACK_SIZEOF(uart_cmd_stack),
                    uart_cmd_thread, NULL, NULL, NULL,
                    7, 0, K_NO_WAIT);  /* 优先级7，立即启动 */
    k_thread_name_set(&uart_cmd_tid, "uart_cmd");

    return 0;
}

/* ---------- 输出封装 ---------- */

/**
 * @brief 内部函数：发送成功响应的可变参数版本
 * @param cmd 命令名称
 * @param fmt 格式化字符串（可选）
 * @param ap 可变参数列表
 */
static void vprint_ok(const char *cmd, const char *fmt, va_list ap)
{
    if (fmt && fmt[0]) {
        char buf[160];
        vsnprintk(buf, sizeof(buf), fmt, ap);
        printk("$OK,%s,%s\r\n", cmd, buf);
    } else {
        printk("$OK,%s\r\n", cmd);
    }
}

/**
 * @brief 发送成功响应（公共接口）
 * 
 * 输出格式：$OK,<cmd>,<内容>\r\n
 * 示例：$OK,PING,pong\r\n
 * 
 * @param cmd 命令名称
 * @param fmt 格式化字符串（可选，可为NULL）
 * @param ... 格式化参数
 */
void uart_cmd_send_ok(const char *cmd, const char *fmt, ...)
{
    va_list ap;
    va_start(ap, fmt);
    vprint_ok(cmd, fmt, ap);
    va_end(ap);
}

/**
 * @brief 发送错误响应
 * 
 * 输出格式：$ERR,<cmd>,<code>,<错误描述>\r\n
 * 示例：$ERR,BLE_SCAN,1,MISSING_PARAM:action\r\n
 * 
 * @param cmd 命令名称
 * @param code 错误码（整数）
 * @param fmt 错误描述格式化字符串
 * @param ... 格式化参数
 */
void uart_cmd_send_err(const char *cmd, int code, const char *fmt, ...)
{
    char buf[160];
    va_list ap;
    va_start(ap, fmt);
    vsnprintk(buf, sizeof(buf), fmt, ap);
    va_end(ap);

    printk("$ERR,%s,%d,%s\r\n", cmd, code, buf);
}

/**
 * @brief 发送事件通知
 * 
 * 用于主动上报系统状态变化，如连接建立、断开、扫描开始等
 * 输出格式：$EVT,<topic>,<内容>\r\n
 * 示例：$EVT,BLE,connected,addr=AA:BB:CC:DD:EE:FF\r\n
 * 
 * @param topic 事件主题（如 "BLE", "DF", "UART" 等）
 * @param fmt 事件描述格式化字符串（可选）
 * @param ... 格式化参数
 */
void uart_cmd_send_evt(const char *topic, const char *fmt, ...)
{
    if (fmt && fmt[0]) {
        char buf[180];
        va_list ap;
        va_start(ap, fmt);
        vsnprintk(buf, sizeof(buf), fmt, ap);
        va_end(ap);
        printk("$EVT,%s,%s\r\n", topic, buf);
    } else {
        printk("$EVT,%s\r\n", topic);
    }
}

/* ---------- 参数解析辅助函数（通用工具） ---------- */

/**
 * @brief 从参数数组中查找key=value格式的参数
 * 
 * 在argv数组中查找格式为"key=value"的参数，返回value部分的指针
 * 例如：argv = ["action=start", "interval=100"]
 *      uart_cmd_kv_find(2, argv, "action") 返回 "start"
 * 
 * @param argc 参数个数
 * @param argv 参数数组
 * @param key 要查找的键名
 * @return 如果找到，返回value部分的指针；否则返回NULL
 */
const char *uart_cmd_kv_find(int argc, const char *argv[], const char *key)
{
    size_t klen = strlen(key);
    for (int i = 0; i < argc; i++) {
        const char *s = argv[i];
        if (!s) continue;
        /* 检查是否以"key="开头 */
        if (!strncmp(s, key, klen) && s[klen] == '=') {
            return s + klen + 1;  /* 返回'='后面的value部分 */
        }
    }
    return NULL;
}

/**
 * @brief 解析字符串为32位无符号整数
 * 
 * @param s 待解析的字符串
 * @param out 输出参数，存储解析结果
 * @return 0 成功，-EINVAL 参数无效或解析失败
 */
int uart_cmd_parse_u32(const char *s, uint32_t *out)
{
    if (!s || !out) return -EINVAL;
    char *end = NULL;
    unsigned long v = strtoul(s, &end, 10);
    /* 检查是否完全解析（end指向字符串末尾） */
    if (end == s || *end != '\0') return -EINVAL;
    *out = (uint32_t)v;
    return 0;
}

/**
 * @brief 解析字符串为16位无符号整数
 * 
 * @param s 待解析的字符串
 * @param out 输出参数，存储解析结果
 * @return 0 成功，-EINVAL 参数无效或解析失败
 */
int uart_cmd_parse_u16(const char *s, uint16_t *out)
{
    if (!s || !out) return -EINVAL;
    char *end = NULL;
    unsigned long v = strtoul(s, &end, 10);
    if (end == s || *end != '\0') return -EINVAL;
    if (v > 0xFFFF) return -ERANGE;  /* 超出uint16_t范围 */
    *out = (uint16_t)v;
    return 0;
}

/**
 * @brief 解析字符串为8位无符号整数
 * 
 * @param s 待解析的字符串
 * @param out 输出参数，存储解析结果
 * @return 0 成功，-EINVAL 参数无效或解析失败
 */
int uart_cmd_parse_u8(const char *s, uint8_t *out)
{
    if (!s || !out) return -EINVAL;
    char *end = NULL;
    unsigned long v = strtoul(s, &end, 10);
    if (end == s || *end != '\0') return -EINVAL;
    if (v > 0xFF) return -ERANGE;  /* 超出uint8_t范围 */
    *out = (uint8_t)v;
    return 0;
}

/**
 * @brief 解析字符串为32位有符号整数
 * 
 * @param s 待解析的字符串
 * @param out 输出参数，存储解析结果
 * @return 0 成功，-EINVAL 参数无效或解析失败
 */
int uart_cmd_parse_i32(const char *s, int32_t *out)
{
    if (!s || !out) return -EINVAL;
    char *end = NULL;
    long v = strtol(s, &end, 10);
    if (end == s || *end != '\0') return -EINVAL;
    if (v < INT32_MIN || v > INT32_MAX) return -ERANGE;
    *out = (int32_t)v;
    return 0;
}
```

## src/uart_cmd.h
```c
#pragma once

#include <stddef.h>
#include <stdint.h>

#ifdef __cplusplus
extern "C" {
#endif

/**
 * @brief 命令处理函数类型定义
 * @param cmd 命令名称（如 "PING", "BLE_SCAN" 等）
 * @param argc 参数个数（不包括命令名本身）
 * @param argv 参数数组，每个参数可能是 "key=value" 格式或普通字符串
 */
typedef void (*uart_cmd_handler_t)(const char *cmd, int argc, const char *argv[]);

/**
 * @brief 初始化串口命令接收系统
 * 
 * 该函数会：
 * 1. 初始化UART设备（使用设备树中定义的zephyr_console）
 * 2. 创建并启动一个后台线程用于解析命令
 * 3. 启用UART接收中断，将接收到的数据放入ring buffer
 * 4. 注册命令处理回调函数
 * 
 * @param handler 命令处理回调函数，当解析到有效命令时会调用此函数
 * @return 0 成功，负数表示错误码
 */
int uart_cmd_init(uart_cmd_handler_t handler);

/**
 * @brief 发送成功响应
 * 
 * 输出格式：$OK,<cmd>,<fmt内容>\r\n
 * 例如：$OK,PING,pong\r\n
 * 
 * @param cmd 命令名称
 * @param fmt 格式化字符串（可选，可为NULL或空字符串）
 * @param ... 格式化参数
 */
void uart_cmd_send_ok(const char *cmd, const char *fmt, ...);

/**
 * @brief 发送错误响应
 * 
 * 输出格式：$ERR,<cmd>,<code>,<fmt内容>\r\n
 * 例如：$ERR,BLE_SCAN,1,MISSING_PARAM:action\r\n
 * 
 * @param cmd 命令名称
 * @param code 错误码（整数）
 * @param fmt 错误描述格式化字符串
 * @param ... 格式化参数
 */
void uart_cmd_send_err(const char *cmd, int code, const char *fmt, ...);

/**
 * @brief 发送事件通知
 * 
 * 用于主动上报系统状态变化，如连接建立、断开等
 * 输出格式：$EVT,<topic>,<fmt内容>\r\n
 * 例如：$EVT,BLE,connected,addr=AA:BB:CC:DD:EE:FF\r\n
 * 
 * @param topic 事件主题（如 "BLE", "DF", "UART" 等）
 * @param fmt 事件描述格式化字符串（可选）
 * @param ... 格式化参数
 */
void uart_cmd_send_evt(const char *topic, const char *fmt, ...);

/* ---------- 参数解析辅助函数（通用工具） ---------- */

/**
 * @brief 从参数数组中查找key=value格式的参数
 * 
 * 在argv数组中查找格式为"key=value"的参数，返回value部分的指针
 * 例如：argv = ["action=start", "interval=100"]
 *      uart_cmd_kv_find(2, argv, "action") 返回 "start"
 * 
 * @param argc 参数个数
 * @param argv 参数数组
 * @param key 要查找的键名
 * @return 如果找到，返回value部分的指针；否则返回NULL
 */
const char *uart_cmd_kv_find(int argc, const char *argv[], const char *key);

/**
 * @brief 解析字符串为32位无符号整数
 * 
 * @param s 待解析的字符串
 * @param out 输出参数，存储解析结果
 * @return 0 成功，-EINVAL 参数无效或解析失败
 */
int uart_cmd_parse_u32(const char *s, uint32_t *out);

/**
 * @brief 解析字符串为16位无符号整数
 * 
 * @param s 待解析的字符串
 * @param out 输出参数，存储解析结果
 * @return 0 成功，-EINVAL 参数无效或解析失败
 */
int uart_cmd_parse_u16(const char *s, uint16_t *out);

/**
 * @brief 解析字符串为8位无符号整数
 * 
 * @param s 待解析的字符串
 * @param out 输出参数，存储解析结果
 * @return 0 成功，-EINVAL 参数无效或解析失败
 */
int uart_cmd_parse_u8(const char *s, uint8_t *out);

/**
 * @brief 解析字符串为32位有符号整数
 * 
 * @param s 待解析的字符串
 * @param out 输出参数，存储解析结果
 * @return 0 成功，-EINVAL 参数无效或解析失败
 */
int uart_cmd_parse_i32(const char *s, int32_t *out);

#ifdef __cplusplus
}
#endif
```
