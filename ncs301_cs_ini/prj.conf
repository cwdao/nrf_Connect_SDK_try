## CMakeLists.txt
```
#
# Copyright (c) 2024 Nordic Semiconductor
#
# SPDX-License-Identifier: LicenseRef-Nordic-5-Clause
#

cmake_minimum_required(VERSION 3.20.0)

find_package(Zephyr REQUIRED HINTS $ENV{ZEPHYR_BASE})
project(ncs301_cs_ini)

FILE(GLOB app_sources src/*.c)
# NORDIC SDK APP START
target_sources(app PRIVATE
	${app_sources}
)
# NORDIC SDK APP END
```

## prj.conf
```kconfig
#
# Copyright (c) 2024 Nordic Semiconductor ASA
#
# SPDX-License-Identifier: LicenseRef-Nordic-5-Clause
#

CONFIG_NCS_SAMPLES_DEFAULTS=y
CONFIG_DK_LIBRARY=y

CONFIG_BT=y
CONFIG_BT_SMP=y
CONFIG_BT_CENTRAL=y
CONFIG_BT_MAX_CONN=1
CONFIG_BT_BONDABLE=n

CONFIG_BT_GATT_CLIENT=y
CONFIG_BT_GATT_DYNAMIC_DB=y

CONFIG_BT_CHANNEL_SOUNDING=y
CONFIG_BT_RAS=y
CONFIG_BT_RAS_RREQ=y

CONFIG_BT_SCAN=y
CONFIG_BT_SCAN_FILTER_ENABLE=y
CONFIG_BT_SCAN_UUID_CNT=1

# The Ranging Profile recommends a MTU of at least 247 octets.
CONFIG_BT_L2CAP_TX_MTU=498
CONFIG_BT_BUF_ACL_TX_SIZE=502
CONFIG_BT_BUF_ACL_RX_SIZE=502
CONFIG_BT_ATT_PREPARE_COUNT=3
CONFIG_BT_CTLR_DATA_LENGTH_MAX=251

# This reduces RAM usage. Additional RAM is needed to support optional
# features such as mode 3 or multiantenna. Change or remove these if
# using those features
CONFIG_BT_RAS_MODE_3_SUPPORTED=n
CONFIG_BT_RAS_MAX_ANTENNA_PATHS=1
CONFIG_BT_CTLR_SDC_CS_MAX_ANTENNA_PATHS=1
CONFIG_BT_CTLR_SDC_CS_NUM_ANTENNAS=1
CONFIG_BT_CTLR_SDC_CS_STEP_MODE3=n

# This size assumes the largest step size is mode 2 with one antenna path:
# 12 bytes * 160 steps in a subevent. Change or remove this if using mode 3
# or multiantenna.
CONFIG_BT_CHANNEL_SOUNDING_REASSEMBLY_BUFFER_SIZE=1920

# This allows CS and ACL to use different PHYs
CONFIG_BT_TRANSMIT_POWER_CONTROL=y

# This improves the performance of floating-point operations
CONFIG_FPU=y
CONFIG_FPU_SHARING=y

CONFIG_CBPRINTF_FP_SUPPORT=y

CONFIG_BT_CS_DE=y
CONFIG_BT_CS_DE_512_NFFT=y

CONFIG_LOG=y
CONFIG_LOG_DEFAULT_LEVEL=3
CONFIG_LOG_MODE_DEFERRED=y
CONFIG_LOG_BACKEND_UART=y
CONFIG_LOG_BUFFER_SIZE=65536     
# 甚至更大
CONFIG_LOG_PROCESS_TRIGGER_THRESHOLD=256
CONFIG_LOG_PRINTK=y
```

## src/main.c
```c
/*
 * Copyright (c) 2024 Nordic Semiconductor ASA
 *
 * SPDX-License-Identifier: LicenseRef-Nordic-5-Clause
 */

/** @file
 *  @brief Channel Sounding Initiator with Ranging Requestor sample
 */

#include <bluetooth/cs_de.h>
#include <bluetooth/gatt_dm.h>
#include <bluetooth/scan.h>
#include <bluetooth/services/ras.h>
#include <math.h>
#include <zephyr/bluetooth/conn.h>
#include <zephyr/bluetooth/cs.h>
#include <zephyr/bluetooth/gatt.h>
#include <zephyr/kernel.h>
#include <zephyr/sys/reboot.h>
#include <zephyr/types.h>

#include <dk_buttons_and_leds.h>

#include <zephyr/logging/log.h>
LOG_MODULE_REGISTER(app_main, LOG_LEVEL_INF);

#define CON_STATUS_LED DK_LED1

#define CS_CONFIG_ID 0
#define NUM_MODE_0_STEPS 3
#define PROCEDURE_COUNTER_NONE (-1)
#define DE_SLIDING_WINDOW_SIZE (10)
#define MAX_AP (CONFIG_BT_RAS_MAX_ANTENNA_PATHS)

#define LOCAL_PROCEDURE_MEM                                                    \
  ((BT_RAS_MAX_STEPS_PER_PROCEDURE * sizeof(struct bt_le_cs_subevent_step)) +  \
   (BT_RAS_MAX_STEPS_PER_PROCEDURE * BT_RAS_MAX_STEP_DATA_LEN))

static K_SEM_DEFINE(sem_remote_capabilities_obtained, 0, 1);
static K_SEM_DEFINE(sem_config_created, 0, 1);
static K_SEM_DEFINE(sem_cs_security_enabled, 0, 1);
static K_SEM_DEFINE(sem_connected, 0, 1);
static K_SEM_DEFINE(sem_discovery_done, 0, 1);
static K_SEM_DEFINE(sem_mtu_exchange_done, 0, 1);
static K_SEM_DEFINE(sem_security, 0, 1);
static K_SEM_DEFINE(sem_local_steps, 1, 1);

static K_MUTEX_DEFINE(distance_estimate_buffer_mutex);

static struct bt_conn *connection;
NET_BUF_SIMPLE_DEFINE_STATIC(latest_local_steps, LOCAL_PROCEDURE_MEM);
NET_BUF_SIMPLE_DEFINE_STATIC(latest_peer_steps, BT_RAS_PROCEDURE_MEM);
static int32_t most_recent_local_ranging_counter = PROCEDURE_COUNTER_NONE;
static int32_t dropped_ranging_counter = PROCEDURE_COUNTER_NONE;

static uint8_t buffer_index;
static uint8_t buffer_num_valid;
static cs_de_dist_estimates_t distance_estimate_buffer[MAX_AP]
                                                      [DE_SLIDING_WINDOW_SIZE];

static void store_distance_estimates(cs_de_report_t *p_report) {
  int lock_state = k_mutex_lock(&distance_estimate_buffer_mutex, K_FOREVER);

  __ASSERT_NO_MSG(lock_state == 0);

  for (uint8_t ap = 0; ap < p_report->n_ap; ap++) {
    memcpy(&distance_estimate_buffer[ap][buffer_index],
           &p_report->distance_estimates[ap], sizeof(cs_de_dist_estimates_t));
  }

  buffer_index = (buffer_index + 1) % DE_SLIDING_WINDOW_SIZE;

  if (buffer_num_valid < DE_SLIDING_WINDOW_SIZE) {
    buffer_num_valid++;
  }

  k_mutex_unlock(&distance_estimate_buffer_mutex);
}

static cs_de_dist_estimates_t get_distance(uint8_t ap) {
  cs_de_dist_estimates_t averaged_result = {};
  uint8_t num_ifft = 0;
  uint8_t num_phase_slope = 0;
  uint8_t num_rtt = 0;

  int lock_state = k_mutex_lock(&distance_estimate_buffer_mutex, K_FOREVER);

  __ASSERT_NO_MSG(lock_state == 0);

  for (uint8_t i = 0; i < buffer_num_valid; i++) {
    if (isfinite(distance_estimate_buffer[ap][i].ifft)) {
      num_ifft++;
      averaged_result.ifft += distance_estimate_buffer[ap][i].ifft;
    }
    if (isfinite(distance_estimate_buffer[ap][i].phase_slope)) {
      num_phase_slope++;
      averaged_result.phase_slope +=
          distance_estimate_buffer[ap][i].phase_slope;
    }
    if (isfinite(distance_estimate_buffer[ap][i].rtt)) {
      num_rtt++;
      averaged_result.rtt += distance_estimate_buffer[ap][i].rtt;
    }
  }

  k_mutex_unlock(&distance_estimate_buffer_mutex);

  if (num_ifft) {
    averaged_result.ifft /= num_ifft;
  }

  if (num_phase_slope) {
    averaged_result.phase_slope /= num_phase_slope;
  }

  if (num_rtt) {
    averaged_result.rtt /= num_rtt;
  }

  return averaged_result;
}

/** ranging_data_ready_cb 的下一步 */
static void ranging_data_get_complete_cb(struct bt_conn *conn,
                                         uint16_t ranging_counter, int err) {
  ARG_UNUSED(conn);

  if (err) {
    LOG_ERR("Error when getting ranging data with ranging counter %d (err %d)",
            ranging_counter, err);
    return;
  }

  LOG_DBG("Ranging data get completed for ranging counter %d", ranging_counter);

  /* This struct is static to avoid putting it on the stack (it's very large) */
  static cs_de_report_t cs_de_report;
  /** 这一步解析本地和对端的测距步骤数据，把其中的 IQ 数据拷贝进
   * cs_de_report.iq_tones 结构。 */
  cs_de_populate_report(&latest_local_steps, &latest_peer_steps,
                        BT_CONN_LE_CS_ROLE_INITIATOR, &cs_de_report);

  net_buf_simple_reset(&latest_local_steps);
  net_buf_simple_reset(&latest_peer_steps);
  k_sem_give(&sem_local_steps);

  cs_de_quality_t quality = cs_de_calc(&cs_de_report);

  if (quality == CS_DE_QUALITY_OK) {
    for (uint8_t ap = 0; ap < cs_de_report.n_ap; ap++) {
      if (cs_de_report.tone_quality[ap] == CS_DE_TONE_QUALITY_OK) {
        store_distance_estimates(&cs_de_report);
      }
    }
  }
}
/** 这是注册在蓝牙协议栈的 subevent 回调（见
BT_CONN_CB_DEFINE(conn_cb)），每当一次测距子事件完成，就会被调用。

作用：把本轮采集到的 IQ/RTT 原始数据拷贝到 latest_local_steps 缓冲区 */
static void subevent_result_cb(struct bt_conn *conn,
                               struct bt_conn_le_cs_subevent_result *result) {
  if (dropped_ranging_counter == result->header.procedure_counter) {
    return;
  }

  if (most_recent_local_ranging_counter !=
      bt_ras_rreq_get_ranging_counter(result->header.procedure_counter)) {
    int sem_state = k_sem_take(&sem_local_steps, K_NO_WAIT);

    if (sem_state < 0) {
      dropped_ranging_counter = result->header.procedure_counter;
      LOG_DBG(
          "Dropped subevent results due to unfinished ranging data request.");
      return;
    }

    most_recent_local_ranging_counter =
        bt_ras_rreq_get_ranging_counter(result->header.procedure_counter);
  }

  if (result->header.subevent_done_status == BT_CONN_LE_CS_SUBEVENT_ABORTED) {
    /* The steps from this subevent will not be used. */
  } else if (result->step_data_buf) {
    if (result->step_data_buf->len <=
        net_buf_simple_tailroom(&latest_local_steps)) {
      uint16_t len = result->step_data_buf->len;
      uint8_t *step_data = net_buf_simple_pull_mem(result->step_data_buf, len);

      net_buf_simple_add_mem(&latest_local_steps, step_data, len);
    } else {
      LOG_ERR("Not enough memory to store step data. (%d > %d)",
              latest_local_steps.len + result->step_data_buf->len,
              latest_local_steps.size);
      net_buf_simple_reset(&latest_local_steps);
      dropped_ranging_counter = result->header.procedure_counter;
      return;
    }
  }

  dropped_ranging_counter = PROCEDURE_COUNTER_NONE;

  if (result->header.procedure_done_status ==
      BT_CONN_LE_CS_PROCEDURE_COMPLETE) {
    most_recent_local_ranging_counter =
        bt_ras_rreq_get_ranging_counter(result->header.procedure_counter);
  } else if (result->header.procedure_done_status ==
             BT_CONN_LE_CS_PROCEDURE_ABORTED) {
    LOG_WRN("Procedure %u aborted", result->header.procedure_counter);
    net_buf_simple_reset(&latest_local_steps);
    k_sem_give(&sem_local_steps);
  }
}

/** 当测距数据全部采集完成，会触发这个回调。
作用：调用 bt_ras_rreq_cp_get_ranging_data，从协议栈获取对端数据，填入
latest_peer_steps，并最终调用 ranging_data_get_complete_cb。
latest_local_steps：存储本地采集到的测距步骤数据（IQ/RTT）
latest_peer_steps：存储通过 HCI/ATT 获取的对端测距步骤数据 */
static void ranging_data_ready_cb(struct bt_conn *conn,
                                  uint16_t ranging_counter) {
  LOG_DBG("Ranging data ready %i", ranging_counter);

  if (ranging_counter == most_recent_local_ranging_counter) {
    int err = bt_ras_rreq_cp_get_ranging_data(connection, &latest_peer_steps,
                                              ranging_counter,
                                              ranging_data_get_complete_cb);
    if (err) {
      LOG_ERR("Get ranging data failed (err %d)", err);
      net_buf_simple_reset(&latest_local_steps);
      net_buf_simple_reset(&latest_peer_steps);
      k_sem_give(&sem_local_steps);
    }
  }
}

static void ranging_data_overwritten_cb(struct bt_conn *conn,
                                        uint16_t ranging_counter) {
  LOG_INF("Ranging data overwritten %i", ranging_counter);
}

static void mtu_exchange_cb(struct bt_conn *conn, uint8_t err,
                            struct bt_gatt_exchange_params *params) {
  if (err) {
    LOG_ERR("MTU exchange failed (err %d)", err);
    return;
  }

  LOG_INF("MTU exchange success (%u)", bt_gatt_get_mtu(conn));
  k_sem_give(&sem_mtu_exchange_done);
}

static void discovery_completed_cb(struct bt_gatt_dm *dm, void *context) {
  int err;

  LOG_INF("The discovery procedure succeeded");

  struct bt_conn *conn = bt_gatt_dm_conn_get(dm);

  bt_gatt_dm_data_print(dm);

  err = bt_ras_rreq_alloc_and_assign_handles(dm, conn);
  if (err) {
    LOG_ERR("RAS RREQ alloc init failed (err %d)", err);
  }

  err = bt_gatt_dm_data_release(dm);
  if (err) {
    LOG_ERR("Could not release the discovery data (err %d)", err);
  }

  k_sem_give(&sem_discovery_done);
}

static void discovery_service_not_found_cb(struct bt_conn *conn,
                                           void *context) {
  LOG_INF("The service could not be found during the discovery, disconnecting");
  bt_conn_disconnect(connection, BT_HCI_ERR_REMOTE_USER_TERM_CONN);
}

static void discovery_error_found_cb(struct bt_conn *conn, int err,
                                     void *context) {
  LOG_INF("The discovery procedure failed (err %d)", err);
  bt_conn_disconnect(connection, BT_HCI_ERR_REMOTE_USER_TERM_CONN);
}

static struct bt_gatt_dm_cb discovery_cb = {
    .completed = discovery_completed_cb,
    .service_not_found = discovery_service_not_found_cb,
    .error_found = discovery_error_found_cb,
};

static void security_changed(struct bt_conn *conn, bt_security_t level,
                             enum bt_security_err err) {
  char addr[BT_ADDR_LE_STR_LEN];

  bt_addr_le_to_str(bt_conn_get_dst(conn), addr, sizeof(addr));

  if (err) {
    LOG_ERR("Security failed: %s level %u err %d %s", addr, level, err,
            bt_security_err_to_str(err));
    return;
  }

  LOG_INF("Security changed: %s level %u", addr, level);
  k_sem_give(&sem_security);
}

static bool le_param_req(struct bt_conn *conn, struct bt_le_conn_param *param) {
  /* Ignore peer parameter preferences. */
  return false;
}

static void connected_cb(struct bt_conn *conn, uint8_t err) {
  char addr[BT_ADDR_LE_STR_LEN];

  (void)bt_addr_le_to_str(bt_conn_get_dst(conn), addr, sizeof(addr));
  LOG_INF("Connected to %s (err 0x%02X)", addr, err);

  if (err) {
    bt_conn_unref(conn);
    connection = NULL;
  }

  connection = bt_conn_ref(conn);

  k_sem_give(&sem_connected);

  dk_set_led_on(CON_STATUS_LED);
}

static void disconnected_cb(struct bt_conn *conn, uint8_t reason) {
  LOG_INF("Disconnected (reason 0x%02X)", reason);

  bt_conn_unref(conn);
  connection = NULL;
  dk_set_led_off(CON_STATUS_LED);

  sys_reboot(SYS_REBOOT_COLD);
}

static void remote_capabilities_cb(struct bt_conn *conn, uint8_t status,
                                   struct bt_conn_le_cs_capabilities *params) {
  ARG_UNUSED(conn);
  ARG_UNUSED(params);

  if (status == BT_HCI_ERR_SUCCESS) {
    LOG_INF("CS capability exchange completed.");
    k_sem_give(&sem_remote_capabilities_obtained);
  } else {
    LOG_WRN("CS capability exchange failed. (HCI status 0x%02x)", status);
  }
}

static void config_create_cb(struct bt_conn *conn, uint8_t status,
                             struct bt_conn_le_cs_config *config) {
  ARG_UNUSED(conn);

  if (status == BT_HCI_ERR_SUCCESS) {
    LOG_INF("CS config creation complete. ID: %d", config->id);
    k_sem_give(&sem_config_created);
  } else {
    LOG_WRN("CS config creation failed. (HCI status 0x%02x)", status);
  }
}

static void security_enable_cb(struct bt_conn *conn, uint8_t status) {
  ARG_UNUSED(conn);

  if (status == BT_HCI_ERR_SUCCESS) {
    LOG_INF("CS security enabled.");
    k_sem_give(&sem_cs_security_enabled);
  } else {
    LOG_WRN("CS security enable failed. (HCI status 0x%02x)", status);
  }
}

static void
procedure_enable_cb(struct bt_conn *conn, uint8_t status,
                    struct bt_conn_le_cs_procedure_enable_complete *params) {
  ARG_UNUSED(conn);

  if (status == BT_HCI_ERR_SUCCESS) {
    if (params->state == 1) {
      LOG_INF("CS procedures enabled:\n"
              " - config ID: %u\n"
              " - antenna configuration index: %u\n"
              " - TX power: %d dbm\n"
              " - subevent length: %u us\n"
              " - subevents per event: %u\n"
              " - subevent interval: %u\n"
              " - event interval: %u\n"
              " - procedure interval: %u\n"
              " - procedure count: %u\n"
              " - maximum procedure length: %u",
              params->config_id, params->tone_antenna_config_selection,
              params->selected_tx_power, params->subevent_len,
              params->subevents_per_event, params->subevent_interval,
              params->event_interval, params->procedure_interval,
              params->procedure_count, params->max_procedure_len);
    } else {
      LOG_INF("CS procedures disabled.");
    }
  } else {
    LOG_WRN("CS procedures enable failed. (HCI status 0x%02x)", status);
  }
}

static void scan_filter_match(struct bt_scan_device_info *device_info,
                              struct bt_scan_filter_match *filter_match,
                              bool connectable) {
  char addr[BT_ADDR_LE_STR_LEN];

  bt_addr_le_to_str(device_info->recv_info->addr, addr, sizeof(addr));

  LOG_INF("Filters matched. Address: %s connectable: %d", addr, connectable);
}

static void scan_connecting_error(struct bt_scan_device_info *device_info) {
  int err;

  LOG_INF("Connecting failed, restarting scanning");

  err = bt_scan_start(BT_SCAN_TYPE_SCAN_PASSIVE);
  if (err) {
    LOG_ERR("Failed to restart scanning (err %i)", err);
    return;
  }
}

static void scan_connecting(struct bt_scan_device_info *device_info,
                            struct bt_conn *conn) {
  LOG_INF("Connecting");
}

BT_SCAN_CB_INIT(scan_cb, scan_filter_match, NULL, scan_connecting_error,
                scan_connecting);

static int scan_init(void) {
  int err;

  struct bt_scan_init_param param = {.scan_param = NULL,
                                     .conn_param = BT_LE_CONN_PARAM_DEFAULT,
                                     .connect_if_match = 1};

  bt_scan_init(&param);
  bt_scan_cb_register(&scan_cb);

  err = bt_scan_filter_add(BT_SCAN_FILTER_TYPE_UUID, BT_UUID_RANGING_SERVICE);
  if (err) {
    LOG_ERR("Scanning filters cannot be set (err %d)", err);
    return err;
  }

  err = bt_scan_filter_enable(BT_SCAN_UUID_FILTER, false);
  if (err) {
    LOG_ERR("Filters cannot be turned on (err %d)", err);
    return err;
  }

  return 0;
}

BT_CONN_CB_DEFINE(conn_cb) = {
    .connected = connected_cb,
    .disconnected = disconnected_cb,
    .le_param_req = le_param_req,
    .security_changed = security_changed,
    .le_cs_read_remote_capabilities_complete = remote_capabilities_cb,
    .le_cs_config_complete = config_create_cb,
    .le_cs_security_enable_complete = security_enable_cb,
    .le_cs_procedure_enable_complete = procedure_enable_cb,
    .le_cs_subevent_data_available = subevent_result_cb,
};

int main(void) {
  int err;

  LOG_INF("Starting Channel Sounding Initiator Sample");

  dk_leds_init();

  err = bt_enable(NULL);
  if (err) {
    LOG_ERR("Bluetooth init failed (err %d)", err);
    return 0;
  }

  err = scan_init();
  if (err) {
    LOG_ERR("Scan init failed (err %d)", err);
    return 0;
  }

  err = bt_scan_start(BT_SCAN_TYPE_SCAN_PASSIVE);
  if (err) {
    LOG_ERR("Scanning failed to start (err %i)", err);
    return 0;
  }

  k_sem_take(&sem_connected, K_FOREVER);

  err = bt_conn_set_security(connection, BT_SECURITY_L2);
  if (err) {
    LOG_ERR("Failed to encrypt connection (err %d)", err);
    return 0;
  }

  k_sem_take(&sem_security, K_FOREVER);

  static struct bt_gatt_exchange_params mtu_exchange_params = {
      .func = mtu_exchange_cb};

  bt_gatt_exchange_mtu(connection, &mtu_exchange_params);

  k_sem_take(&sem_mtu_exchange_done, K_FOREVER);

  err = bt_gatt_dm_start(connection, BT_UUID_RANGING_SERVICE, &discovery_cb,
                         NULL);
  if (err) {
    LOG_ERR("Discovery failed (err %d)", err);
    return 0;
  }

  k_sem_take(&sem_discovery_done, K_FOREVER);

  const struct bt_le_cs_set_default_settings_param default_settings = {
      .enable_initiator_role = true,
      .enable_reflector_role = false,
      .cs_sync_antenna_selection = BT_LE_CS_ANTENNA_SELECTION_OPT_REPETITIVE,
      .max_tx_power = BT_HCI_OP_LE_CS_MAX_MAX_TX_POWER,
  };

  err = bt_le_cs_set_default_settings(connection, &default_settings);
  if (err) {
    LOG_ERR("Failed to configure default CS settings (err %d)", err);
    return 0;
  }

  err = bt_ras_rreq_rd_overwritten_subscribe(connection,
                                             ranging_data_overwritten_cb);
  if (err) {
    LOG_ERR("RAS RREQ ranging data overwritten subscribe failed (err %d)", err);
    return 0;
  }

  err = bt_ras_rreq_rd_ready_subscribe(connection, ranging_data_ready_cb);
  if (err) {
    LOG_ERR("RAS RREQ ranging data ready subscribe failed (err %d)", err);
    return 0;
  }

  err = bt_ras_rreq_on_demand_rd_subscribe(connection);
  if (err) {
    LOG_ERR("RAS RREQ On-demand ranging data subscribe failed (err %d)", err);
    return 0;
  }

  err = bt_ras_rreq_cp_subscribe(connection);
  if (err) {
    LOG_ERR("RAS RREQ CP subscribe failed (err %d)", err);
    return 0;
  }

  err = bt_le_cs_read_remote_supported_capabilities(connection);
  if (err) {
    LOG_ERR("Failed to exchange CS capabilities (err %d)", err);
    return 0;
  }

  k_sem_take(&sem_remote_capabilities_obtained, K_FOREVER);

  struct bt_le_cs_create_config_params config_params = {
      .id = CS_CONFIG_ID,
      .main_mode_type = BT_CONN_LE_CS_MAIN_MODE_2,
      .sub_mode_type = BT_CONN_LE_CS_SUB_MODE_1,
      .min_main_mode_steps = 2,
      .max_main_mode_steps = 5,
      .main_mode_repetition = 0,
      .mode_0_steps = NUM_MODE_0_STEPS,
      .role = BT_CONN_LE_CS_ROLE_INITIATOR,
      .rtt_type = BT_CONN_LE_CS_RTT_TYPE_AA_ONLY,
      .cs_sync_phy = BT_CONN_LE_CS_SYNC_1M_PHY,
      .channel_map_repetition = 3,
      .channel_selection_type = BT_CONN_LE_CS_CHSEL_TYPE_3B,
      .ch3c_shape = BT_CONN_LE_CS_CH3C_SHAPE_HAT,
      .ch3c_jump = 2,
  };

  bt_le_cs_set_valid_chmap_bits(config_params.channel_map);

  err = bt_le_cs_create_config(connection, &config_params,
                               BT_LE_CS_CREATE_CONFIG_CONTEXT_LOCAL_AND_REMOTE);
  if (err) {
    LOG_ERR("Failed to create CS config (err %d)", err);
    return 0;
  }

  k_sem_take(&sem_config_created, K_FOREVER);

  err = bt_le_cs_security_enable(connection);
  if (err) {
    LOG_ERR("Failed to start CS Security (err %d)", err);
    return 0;
  }

  k_sem_take(&sem_cs_security_enabled, K_FOREVER);

  const struct bt_le_cs_set_procedure_parameters_param procedure_params = {
      .config_id = CS_CONFIG_ID,
      .max_procedure_len = 1000,
      .min_procedure_interval = 1,
      .max_procedure_interval = 5,
      .max_procedure_count = 0,
      .min_subevent_len = 60000,
      .max_subevent_len = 60000,
      .tone_antenna_config_selection =
          BT_LE_CS_TONE_ANTENNA_CONFIGURATION_A1_B1,
      .phy = BT_LE_CS_PROCEDURE_PHY_1M,
      .tx_power_delta = 0x80,
      .preferred_peer_antenna = BT_LE_CS_PROCEDURE_PREFERRED_PEER_ANTENNA_1,
      .snr_control_initiator = BT_LE_CS_SNR_CONTROL_NOT_USED,
      .snr_control_reflector = BT_LE_CS_SNR_CONTROL_NOT_USED,
  };

  err = bt_le_cs_set_procedure_parameters(connection, &procedure_params);
  if (err) {
    LOG_ERR("Failed to set procedure parameters (err %d)", err);
    return 0;
  }

  struct bt_le_cs_procedure_enable_param params = {
      .config_id = CS_CONFIG_ID,
      .enable = 1,
  };

  err = bt_le_cs_procedure_enable(connection, &params);
  if (err) {
    LOG_ERR("Failed to enable CS procedures (err %d)", err);
    return 0;
  }

  while (true) {
    k_sleep(K_MSEC(5000));

    if (buffer_num_valid != 0) {
      for (uint8_t ap = 0; ap < MAX_AP; ap++) {
        cs_de_dist_estimates_t distance_on_ap = get_distance(ap);

        LOG_INF("Distance estimates on antenna path %u: ifft: %f, "
                "phase_slope: %f, rtt: %f",
                ap, (double)distance_on_ap.ifft,
                (double)distance_on_ap.phase_slope, (double)distance_on_ap.rtt);
      }
    }

    LOG_INF("Sleeping for a few seconds...");
  }

  return 0;
}
```

## src/301_cs_de.c
```c
/*
 * Copyright (c) 2025 Nordic Semiconductor ASA
 *
 * SPDX-License-Identifier: LicenseRef-Nordic-5-Clause
 */

#include <math.h>
#include <stdbool.h>
#include <stdlib.h>
#include <string.h>

#include <arm_const_structs.h>
#include <bluetooth/cs_de.h>
#include <bluetooth/services/ras.h>
#include <dsp/fast_math_functions.h>
#include <dsp/statistics_functions.h>
#include <dsp/transform_functions.h>
#include <zephyr/bluetooth/hci_types.h>
#include <zephyr/logging/log.h>

LOG_MODULE_REGISTER(cs_de, CONFIG_BT_CS_DE_LOG_LEVEL);

#define PI 3.14159265358979f
#define SPEED_OF_LIGHT_M_PER_S (299792458.0f)

#define CHANNEL_INDEX_OFFSET (2)
#define NUM_CHANNELS (75)

#define TONE_QI_BAD_TONE_COUNT_THRESHOLD (4)

#define PHASE_INVALID (2 * PI)

#define CHANNEL_SPACING_HZ (1e6f)
#define DMEYR (1)
#define NORMAL_PEAK_TO_NULL                                                    \
  ((CONFIG_BT_CS_DE_NFFT_SIZE + NUM_CHANNELS - 1) / (NUM_CHANNELS))

static float m_iq_scratch_mem[2 * CONFIG_BT_CS_DE_NFFT_SIZE];
static uint16_t m_n_iqs[CONFIG_BT_RAS_MAX_ANTENNA_PATHS][NUM_CHANNELS];
static cs_de_tone_quality_t
    m_tone_quality_indicators[CONFIG_BT_RAS_MAX_ANTENNA_PATHS][NUM_CHANNELS];

static void calculate_vec_cmac_f(float *iq_result, const float *i_1,
                                 const float *q_1, const float *i_2,
                                 const float *q_2) {
  for (uint32_t n = 0; n < NUM_CHANNELS; n++) {
    iq_result[2 * n] = i_1[n] * i_2[n] - q_1[n] * q_2[n];
    iq_result[2 * n + 1] = i_1[n] * q_2[n] + i_2[n] * q_1[n];
  }
}

static cs_de_quality_t
set_best_estimate(cs_de_dist_estimates_t *p_estimates_public) {
  cs_de_quality_t data_quality = CS_DE_QUALITY_OK;

  if (isfinite(p_estimates_public->ifft)) {
    p_estimates_public->best = p_estimates_public->ifft;
  } else if (isfinite(p_estimates_public->phase_slope)) {
    p_estimates_public->best = p_estimates_public->phase_slope;
  } else if (isfinite(p_estimates_public->rtt)) {
    p_estimates_public->best = p_estimates_public->rtt;
  } else {
    data_quality = CS_DE_QUALITY_DO_NOT_USE;
    p_estimates_public->best = 0.0f;
  }

  return data_quality;
}

static void calculate_dist_d_spaced_kay_f(float *dist, float *iq, uint32_t D) {
  float sum_i = 0;
  float sum_q = 0;

  for (uint32_t n = D; n < NUM_CHANNELS; n++) {
    sum_i +=
        (iq[2 * n] * iq[2 * (n - D)] + iq[2 * n + 1] * iq[2 * (n - D) + 1]);
    sum_q +=
        (-iq[2 * n] * iq[2 * (n - D) + 1] + iq[2 * n + 1] * iq[2 * (n - D)]);
  }
  *dist = -(SPEED_OF_LIGHT_M_PER_S * atan2f(sum_q, sum_i)) /
          (4.0f * PI * D * CHANNEL_SPACING_HZ);

  if (*dist < 0) {
    *dist = NAN;
  }
}

static float calculate_ifft_peak_index_to_distance(
    int32_t peak_index, const float ifft_mag[CONFIG_BT_CS_DE_NFFT_SIZE]) {
  /* Peak interpolation */
  float prompt = ifft_mag[peak_index];

  /* Find early and late magnitudes, if peak_index is at either first or last
   * point in the IFFT, wrap around since the IFFT is periodic.
   */
  float early = (peak_index != 0) ? ifft_mag[peak_index - 1]
                                  : ifft_mag[CONFIG_BT_CS_DE_NFFT_SIZE - 1];
  float late = (peak_index != (CONFIG_BT_CS_DE_NFFT_SIZE - 1))
                   ? ifft_mag[peak_index + 1]
                   : ifft_mag[0];
  /* Avoid interpolation of early, prompt and late if left null compensation has
   * taken place.
   */
  float t_hat = (prompt >= early && prompt >= late)
                    ? (late - early) / (4 * prompt - 2 * (early + late))
                    : 0.0f;

  float distance = ((peak_index + t_hat) * SPEED_OF_LIGHT_M_PER_S) /
                   (2.0f * CONFIG_BT_CS_DE_NFFT_SIZE * CHANNEL_SPACING_HZ);

  if (peak_index >= (CONFIG_BT_CS_DE_NFFT_SIZE - 2) || distance < 0.0f) {
    distance = NAN;
  }
  return distance;
}

static int32_t
calculate_ifft_find_left_null(int32_t peak_index,
                              float ifft_mag[CONFIG_BT_CS_DE_NFFT_SIZE]) {
  int32_t left_null_index = peak_index;
  bool found_left_null = false;

  while (!found_left_null) {
    int32_t next_left_null_index = left_null_index == 0
                                       ? CONFIG_BT_CS_DE_NFFT_SIZE - 1
                                       : left_null_index - 1;
    /* This is a heuristic, probably non-optimal definition of a null. */
    if ((ifft_mag[left_null_index] * 2 > ifft_mag[peak_index] ||
         ifft_mag[left_null_index] > 1.10f * ifft_mag[next_left_null_index]) &&
        ifft_mag[left_null_index] * 10 > ifft_mag[peak_index] &&
        next_left_null_index != peak_index) {
      left_null_index = next_left_null_index--;
    } else {
      found_left_null = true;
    }
  }
  return left_null_index;
}

static uint32_t calculate_distance_to_left_null(uint32_t peak_index,
                                                uint32_t left_null_index) {
  return left_null_index > peak_index
             ? (CONFIG_BT_CS_DE_NFFT_SIZE + peak_index - left_null_index)
             : (peak_index - left_null_index);
}

static int32_t calculate_left_null_compensation_of_peak(
    int32_t peak_index, float ifft_mag[CONFIG_BT_CS_DE_NFFT_SIZE]) {
  int32_t compensated_peak_index = peak_index;
  int32_t left_null_index = calculate_ifft_find_left_null(peak_index, ifft_mag);
  uint32_t peak_to_null_distance =
      calculate_distance_to_left_null(peak_index, left_null_index);
  if (peak_to_null_distance > NORMAL_PEAK_TO_NULL) {
    if (left_null_index > peak_index) {
      compensated_peak_index = (left_null_index + NORMAL_PEAK_TO_NULL -
                                CONFIG_BT_CS_DE_NFFT_SIZE) > 0
                                   ? (left_null_index + NORMAL_PEAK_TO_NULL -
                                      CONFIG_BT_CS_DE_NFFT_SIZE)
                                   : 0;
    } else {
      compensated_peak_index = left_null_index + NORMAL_PEAK_TO_NULL;
    }
  }
  return compensated_peak_index;
}

static void interpolate_missing_frequencies(float *iq) {
  /* Channels 23, 24, and 25 are not allowed for use with channel sounding.
   * However, the FFT algorithm requires evenly spaced samples.
   * IQ values are therefore linearly interpolated from channels 22 and 26.
   */

  const uint8_t ch_22 = 22 - CHANNEL_INDEX_OFFSET;
  const uint8_t ch_26 = 26 - CHANNEL_INDEX_OFFSET;
  const float i_slope = (iq[2 * ch_26] - iq[2 * ch_22]) / 4.0f;
  const float q_slope = (iq[2 * ch_26 + 1] - iq[2 * ch_22 + 1]) / 4.0f;

  for (uint8_t i = ch_22 + 1; i < ch_26; i++) {
    iq[2 * i] = iq[2 * ch_22] + i_slope * (i - ch_22);
    iq[2 * i + 1] = iq[2 * ch_22 + 1] + q_slope * (i - ch_22);
  }
}

static void
calculate_dist_ifft(float *dist,
                    float iq_tones_comb[2 * CONFIG_BT_CS_DE_NFFT_SIZE]) {
  interpolate_missing_frequencies(iq_tones_comb);

  for (uint8_t n = 0; n < 2 * NUM_CHANNELS; n += 2) {
    if (iq_tones_comb[n] == 0.0f && iq_tones_comb[n + 1] == 0.0f) {
      /* Phase measurements are missing for some channels.
       * FFT cannot be used.
       */
      LOG_DBG("Could not compute iFFT due to missing frequencies.");
      return;
    }
  }

#if CONFIG_BT_CS_DE_NFFT_SIZE == 512
  arm_cfft_f32(&arm_cfft_sR_f32_len512, iq_tones_comb, 0, 1);
#elif CONFIG_BT_CS_DE_NFFT_SIZE == 1024
  arm_cfft_f32(&arm_cfft_sR_f32_len1024, iq_tones_comb, 0, 1);
#elif CONFIG_BT_CS_DE_NFFT_SIZE == 2048
  arm_cfft_f32(&arm_cfft_sR_f32_len2048, iq_tones_comb, 0, 1);
#else
#error
#endif

  /* Compute the magnitude of iq_tones_comb[0:2*CONFIG_BT_CS_DE_NFFT_SIZE - 1],
   * store output in iq_tones_comb[0:CONFIG_BT_CS_DE_NFFT_SIZE - 1]
   */
  for (uint32_t n = 0; n < CONFIG_BT_CS_DE_NFFT_SIZE; n++) {
    float realIn = iq_tones_comb[2 * n];
    float imagIn = iq_tones_comb[(2 * n) + 1];

    arm_sqrt_f32((realIn * realIn) + (imagIn * imagIn), &iq_tones_comb[n]);
  }
  /* Reverse the elements in iq_tones_comb[0:CONFIG_BT_CS_DE_NFFT_SIZE-1] */
  for (uint32_t n = 0; n < CONFIG_BT_CS_DE_NFFT_SIZE / 2; n++) {
    float temp = iq_tones_comb[n];

    iq_tones_comb[n] = iq_tones_comb[CONFIG_BT_CS_DE_NFFT_SIZE - 1 - n];
    iq_tones_comb[CONFIG_BT_CS_DE_NFFT_SIZE - 1 - n] = temp;
  }

  /* The iq_tones_comb array now contains the ifft_mag in the indices
   * [0:CONFIG_BT_CS_DE_NFFT_SIZE-1]
   */
  float *ifft_mag = iq_tones_comb;

  uint32_t ifft_mag_max_index;
  float ifft_mag_max;

  arm_max_f32(ifft_mag, CONFIG_BT_CS_DE_NFFT_SIZE, &ifft_mag_max,
              &ifft_mag_max_index);

  /* Search for strong peaks closer than the max value. */
  uint32_t nw = CONFIG_BT_CS_DE_NFFT_SIZE - 2;
  uint32_t nw_next = CONFIG_BT_CS_DE_NFFT_SIZE - 1;
  uint32_t max_search_index = ifft_mag_max_index;
  bool short_path_found = false;
  bool first_rise_found = false;
  uint32_t shortest_path_idx = ifft_mag_max_index;

  while (nw != max_search_index && !short_path_found) {
    if (ifft_mag[nw_next] < ifft_mag[nw]) {
      /* Peak found */
      if (2.5f * ifft_mag[nw] > ifft_mag_max && first_rise_found) {
        /* New peak found */
        shortest_path_idx = nw;
        short_path_found = true;
      }
    } else {
      first_rise_found = true;
    }
    nw = nw_next;
    nw_next = (nw_next + 1) % CONFIG_BT_CS_DE_NFFT_SIZE;
  }

  uint32_t compensated_peak_index = shortest_path_idx;

  if (compensated_peak_index < CONFIG_BT_CS_DE_NFFT_SIZE - 2) {
    compensated_peak_index =
        calculate_left_null_compensation_of_peak(shortest_path_idx, ifft_mag);
  }

  *dist =
      calculate_ifft_peak_index_to_distance(compensated_peak_index, ifft_mag);
}

static void calculate_dist_rtt(cs_de_report_t *p_report) {
  if (p_report->rtt_count > 0) {
    float rtt_avg_measured_ns =
        (p_report->rtt_accumulated_half_ns * 0.5f) / p_report->rtt_count;
    float tof_ns = rtt_avg_measured_ns / 2.0f;
    float rtt_distance_m = tof_ns * (SPEED_OF_LIGHT_M_PER_S / 1e9f);

    for (uint8_t ap = 0; ap < p_report->n_ap; ap++) {
      if (rtt_distance_m >= 0.0f) {
        p_report->distance_estimates[ap].rtt = rtt_distance_m;
      }
    }
  }
}

static bool m_is_tone_quality_bad(cs_de_tone_quality_t *p_tone_qi) {
  uint8_t bad_tones_count = 0;

  for (uint8_t i = 0; i < NUM_CHANNELS; ++i) {
    if (p_tone_qi[i] == CS_DE_TONE_QUALITY_BAD) {
      bad_tones_count += 1;
    }
  }
  return (bad_tones_count > TONE_QI_BAD_TONE_COUNT_THRESHOLD);
}

static void cumulate_mean(float *avg, float new_value, uint16_t *N) {
  float a = 1.0f / (*N);
  float b = 1.0f - a;
  *avg = a * new_value + b * (*avg);
}

static void
extract_pcts(cs_de_report_t *p_report, uint8_t channel_index,
             uint8_t antenna_permutation_index,
             struct bt_hci_le_cs_step_data_tone_info *local_tone_info,
             struct bt_hci_le_cs_step_data_tone_info *remote_tone_info) {

  for (uint8_t tone_index = 0; tone_index < p_report->n_ap; tone_index++) {
    int antenna_path = bt_le_cs_get_antenna_path(
        p_report->n_ap, antenna_permutation_index, tone_index);
    if (antenna_path < 0) {
      LOG_WRN("Invalid antenna path.");
      return;
    }

    if (local_tone_info[antenna_path].quality_indicator !=
            BT_HCI_LE_CS_TONE_QUALITY_HIGH ||
        remote_tone_info[antenna_path].quality_indicator !=
            BT_HCI_LE_CS_TONE_QUALITY_HIGH) {
      return;
    }

    struct bt_le_cs_iq_sample local_iq =
        bt_le_cs_parse_pct(local_tone_info[antenna_path].phase_correction_term);
    struct bt_le_cs_iq_sample remote_iq = bt_le_cs_parse_pct(
        remote_tone_info[antenna_path].phase_correction_term);

    m_n_iqs[antenna_path][channel_index]++;
    m_tone_quality_indicators[antenna_path][channel_index] =
        CS_DE_TONE_QUALITY_OK;

    if (m_n_iqs[antenna_path][channel_index] == 1) {
      p_report->iq_tones[antenna_path].i_local[channel_index] = local_iq.i;
      p_report->iq_tones[antenna_path].q_local[channel_index] = local_iq.q;
      p_report->iq_tones[antenna_path].i_remote[channel_index] = remote_iq.i;
      p_report->iq_tones[antenna_path].q_remote[channel_index] = remote_iq.q;
    } else {
      cumulate_mean(&p_report->iq_tones[antenna_path].i_local[channel_index],
                    local_iq.i, &m_n_iqs[antenna_path][channel_index]);
      cumulate_mean(&p_report->iq_tones[antenna_path].q_local[channel_index],
                    local_iq.q, &m_n_iqs[antenna_path][channel_index]);
      cumulate_mean(&p_report->iq_tones[antenna_path].i_remote[channel_index],
                    remote_iq.i, &m_n_iqs[antenna_path][channel_index]);
      cumulate_mean(&p_report->iq_tones[antenna_path].q_remote[channel_index],
                    remote_iq.q, &m_n_iqs[antenna_path][channel_index]);
    }
  }
}

static void
extract_rtt_timings(cs_de_report_t *p_report,
                    struct bt_hci_le_cs_step_data_mode_1 *local_rtt_data,
                    struct bt_hci_le_cs_step_data_mode_1 *peer_rtt_data) {
  if (local_rtt_data->packet_quality_aa_check !=
          BT_HCI_LE_CS_PACKET_QUALITY_AA_CHECK_SUCCESSFUL ||
      local_rtt_data->packet_rssi == BT_HCI_LE_CS_PACKET_RSSI_NOT_AVAILABLE ||
      local_rtt_data->tod_toa_reflector ==
          BT_HCI_LE_CS_TIME_DIFFERENCE_NOT_AVAILABLE ||
      peer_rtt_data->packet_quality_aa_check !=
          BT_HCI_LE_CS_PACKET_QUALITY_AA_CHECK_SUCCESSFUL ||
      peer_rtt_data->packet_rssi == BT_HCI_LE_CS_PACKET_RSSI_NOT_AVAILABLE ||
      peer_rtt_data->tod_toa_reflector ==
          BT_HCI_LE_CS_TIME_DIFFERENCE_NOT_AVAILABLE) {
    return;
  }

  if (p_report->role == BT_CONN_LE_CS_ROLE_INITIATOR) {
    p_report->rtt_accumulated_half_ns +=
        local_rtt_data->toa_tod_initiator - peer_rtt_data->tod_toa_reflector;
  } else {
    p_report->rtt_accumulated_half_ns +=
        peer_rtt_data->toa_tod_initiator - local_rtt_data->tod_toa_reflector;
  }

  p_report->rtt_count++;
}

static bool process_ranging_header(struct ras_ranging_header *ranging_header,
                                   void *user_data) {
  cs_de_report_t *p_report = (cs_de_report_t *)user_data;

  p_report->n_ap = ((ranging_header->antenna_paths_mask & BIT(0)) +
                    ((ranging_header->antenna_paths_mask & BIT(1)) >> 1) +
                    ((ranging_header->antenna_paths_mask & BIT(2)) >> 2) +
                    ((ranging_header->antenna_paths_mask & BIT(3)) >> 3));
  return true;
}

static bool process_step_data(struct bt_le_cs_subevent_step *local_step,
                              struct bt_le_cs_subevent_step *peer_step,
                              void *user_data) {
  cs_de_report_t *p_report = (cs_de_report_t *)user_data;

  if (local_step->mode == BT_CONN_LE_CS_MAIN_MODE_2) {
    struct bt_hci_le_cs_step_data_mode_2 *local_step_data =
        (struct bt_hci_le_cs_step_data_mode_2 *)local_step->data;
    struct bt_hci_le_cs_step_data_mode_2 *peer_step_data =
        (struct bt_hci_le_cs_step_data_mode_2 *)peer_step->data;

    extract_pcts(p_report, local_step->channel - CHANNEL_INDEX_OFFSET,
                 local_step_data->antenna_permutation_index,
                 local_step_data->tone_info, peer_step_data->tone_info);
  } else if (local_step->mode == BT_HCI_OP_LE_CS_MAIN_MODE_1) {
    struct bt_hci_le_cs_step_data_mode_1 *local_step_data =
        (struct bt_hci_le_cs_step_data_mode_1 *)local_step->data;
    struct bt_hci_le_cs_step_data_mode_1 *peer_step_data =
        (struct bt_hci_le_cs_step_data_mode_1 *)peer_step->data;

    extract_rtt_timings(p_report, local_step_data, peer_step_data);
  } else if (local_step->mode == BT_HCI_OP_LE_CS_MAIN_MODE_3) {
    struct bt_hci_le_cs_step_data_mode_3 *local_step_data =
        (struct bt_hci_le_cs_step_data_mode_3 *)local_step->data;
    struct bt_hci_le_cs_step_data_mode_3 *peer_step_data =
        (struct bt_hci_le_cs_step_data_mode_3 *)peer_step->data;

    extract_pcts(p_report, local_step->channel - CHANNEL_INDEX_OFFSET,
                 local_step_data->antenna_permutation_index,
                 local_step_data->tone_info, peer_step_data->tone_info);

    extract_rtt_timings(p_report,
                        (struct bt_hci_le_cs_step_data_mode_1 *)local_step_data,
                        (struct bt_hci_le_cs_step_data_mode_1 *)peer_step_data);
  }

  return true;
}

void cs_de_populate_report(struct net_buf_simple *local_steps,
                           struct net_buf_simple *peer_steps,
                           enum bt_conn_le_cs_role role,
                           cs_de_report_t *p_report) {
  memset(p_report, 0x0, sizeof(*p_report));
  memset(m_n_iqs, 0, sizeof(m_n_iqs));
  memset(m_tone_quality_indicators, CS_DE_TONE_QUALITY_BAD,
         sizeof(m_tone_quality_indicators));

  p_report->role = role;

  bt_ras_rreq_rd_subevent_data_parse(peer_steps, local_steps, role,
                                     process_ranging_header, NULL,
                                     process_step_data, p_report);

  for (uint8_t ap = 0; ap < p_report->n_ap; ap++) {
    p_report->distance_estimates[ap].ifft = NAN;
    p_report->distance_estimates[ap].phase_slope = NAN;
    p_report->distance_estimates[ap].rtt = NAN;
    p_report->distance_estimates[ap].best = NAN;

    if (m_is_tone_quality_bad(&m_tone_quality_indicators[ap][0])) {
      p_report->tone_quality[ap] = CS_DE_TONE_QUALITY_BAD;
    } else {
      p_report->tone_quality[ap] = CS_DE_TONE_QUALITY_OK;
    }
  }
}

/** // 输入：cs_de_report_t *p_report（已填充的通道 IQ 采样与 RTT 数据）
// 输出：返回这次测距的质量（OK 或 DO_NOT_USE），并在
p_report->distance_estimates 里写入各天线路径的距离估算结果。
// 主要流程
// RTT 距离估算

// 调用 calculate_dist_rtt，用往返时延粗略估算距离。
// 遍历每个天线通道
// 对每个有效天线通道（ap）：

// 跳过采样质量差的通道（tone_quality == BAD）。
// 将本地与远端的 IQ 数据组合成一个复数向量（calculate_vec_cmac_f）。
// 用 Kay 算法计算信道相位斜率估算距离（calculate_dist_d_spaced_kay_f）。
// 用 IFFT 算法估算距离峰值（calculate_dist_ifft）。
// 综合 IFFT、phase_slope、RTT 三种算法，取最优估算（set_best_estimate）。
// 输出质量判断

// 只要有一个天线通道的测距质量为 OK，则整体认为本次测距有效。
// 否则，返回不可用。*/

cs_de_quality_t cs_de_calc(cs_de_report_t *p_report) {
  /** 声明一个数组，用于存储每个天线路径的距离估算质量（OK或DO_NOT_USE）。初始化为 DO_NOT_USE，即一开始都假定不可用 */
  cs_de_quality_t estimation_quality[CONFIG_BT_RAS_MAX_ANTENNA_PATHS];

  memset(estimation_quality, CS_DE_QUALITY_DO_NOT_USE,
         sizeof(estimation_quality));
  /** 处理 RTT（往返时延）数据，计算 RTT 距离估算值，并填入
   * p_report->distance_estimates[].rtt */
  calculate_dist_rtt(p_report);

  /** 遍历每个天线通道 */
  for (uint8_t ap = 0; ap < p_report->n_ap; ap++) {
    /** 跳过采样质量差的通道（tone_quality == BAD）。 */
    if (p_report->tone_quality[ap] == CS_DE_TONE_QUALITY_BAD) {
      continue;
    }
    /** 清空IQ数据临时存储区（scratch memory），防止上一次残留数据影响计算。 */
    memset(m_iq_scratch_mem, 0, sizeof(m_iq_scratch_mem));

    /* Combine init and refl IQ values and store in scratch mem. */
    /** 把本地和远端的 IQ 数据通过复数乘法组合成一个向量，结果存到临时 scratch
区。 这是物理层测距的标准处理，把两个端的信道响应合成。 */
    calculate_vec_cmac_f(m_iq_scratch_mem, p_report->iq_tones[ap].i_remote,
                         p_report->iq_tones[ap].q_remote,
                         p_report->iq_tones[ap].i_local,
                         p_report->iq_tones[ap].q_local);

    /** 用 Kay 算法计算信道相位斜率估算距离。结果写入 p_report->distance_estimates[ap].phase_slope */
    calculate_dist_d_spaced_kay_f(&p_report->distance_estimates[ap].phase_slope,
                                  m_iq_scratch_mem, DMEYR);

    /** 用 IFFT算法：时域峰值距离估算。结果写入 p_report->distance_estimates[ap].ifft */
    calculate_dist_ifft(&p_report->distance_estimates[ap].ifft,
                        m_iq_scratch_mem);

    estimation_quality[ap] =
        set_best_estimate(&p_report->distance_estimates[ap]);
  }
/** 只要有一条天线路径的距离估算是 OK 的，就返回整体 OK，认为本次测距有效 */
  for (uint8_t ap = 0; ap < p_report->n_ap; ap++) {
    if (estimation_quality[ap] == CS_DE_QUALITY_OK) {
      return CS_DE_QUALITY_OK;
    }
  }

  return CS_DE_QUALITY_DO_NOT_USE;
}
```

## src/301_cs_de.h
```c
/*
 * Copyright (c) 2025 Nordic Semiconductor ASA
 *
 * SPDX-License-Identifier: LicenseRef-Nordic-5-Clause
 */

#ifndef CS_DE_H__
#define CS_DE_H__

#include <zephyr/bluetooth/conn.h>
#include <zephyr/net_buf.h>

/** @file
 *  @defgroup bt_cs_de Channel Sounding Distance Estimation API
 *  @{
 *  @brief API for the Channel Sounding Distance Estimation toolkit.
 */

/**
 * @brief Container of IQ values for local and remote measured tones
 */
typedef struct {
	/** In-phase measurements of tones on this device */
	float i_local[80];
	/** Quadrature-phase measurement of tones on this device */
	float q_local[80];
	/** In-phase measurements of tones from remote device */
	float i_remote[80];
	/** Quadrature-phase measurements of tones from remote device */
	float q_remote[80];
} cs_de_iq_tones_t;

typedef enum {
	CS_DE_TONE_QUALITY_OK,
	CS_DE_TONE_QUALITY_BAD,
} cs_de_tone_quality_t;

/**
 * @brief Container of distance estimate results for a number of different
 * methods, in meters.
 */
typedef struct {
	/** Distance estimate based on inverse fourier transform. */
	float ifft;
	/** Distance estimate based on average phase slope. */
	float phase_slope;
	/** Distance estimate based on RTT. */
	float rtt;
	/** Best effort distance estimate.
	 *
	 *  This is a convenience value which is automatically set to the most
	 *  accurate of the estimation methods.
	 */
	float best;
} cs_de_dist_estimates_t;

/**
 * @brief Quality of the procedure
 */
typedef enum {
	CS_DE_QUALITY_OK,
	CS_DE_QUALITY_DO_NOT_USE,
} cs_de_quality_t;

/**
 * @brief Output data for distance estimation
 */
typedef struct {
	/** CS Role. */
	/** 当前蓝牙测距角色（发起方或响应方）。 */
	enum bt_conn_le_cs_role role;

	/** Number of antenna paths present in data. */
	/** 天线路径数量（多天线、多路径支持）。 */
	uint8_t n_ap;

	/** IQ values for local and remote measured tones. */
	/** 每根天线采集到的本地与远端的 IQ 数据（包括 80 个信道的 I/Q 分量）。 */
	cs_de_iq_tones_t iq_tones[CONFIG_BT_RAS_MAX_ANTENNA_PATHS];

	/** Tone quality indicators */
	/** 每个天线路径的采样质量（OK/BAD）。 */
	cs_de_tone_quality_t tone_quality[CONFIG_BT_RAS_MAX_ANTENNA_PATHS];

	/** Distance estimate results */
	/** 每个天线路径的距离估算结果（IFFT、phase_slope、RTT）。 */
	cs_de_dist_estimates_t distance_estimates[CONFIG_BT_RAS_MAX_ANTENNA_PATHS];

	/** Total time measured during RTT measurements */
	/** 所有 RTT 测量累积的时间（单位：半纳秒）。 */
	int32_t rtt_accumulated_half_ns;

	/** Number of RTT measurements taken */
	/** RTT 测量次数。 */
	uint8_t rtt_count;
} cs_de_report_t;

/**
 * @brief Partially populate the report.
 * This populates the report but does not set the distance estimates and the quality.
 * @param[in] local_steps Buffer to the local step data to parse.
 * @param[in] peer_steps   Buffer to the peer ranging data to parse.
 * @param[in] role Role of the local controller.
 * @param[out] p_report Report populated with the raw data from the last ranging.
 */
void cs_de_populate_report(struct net_buf_simple *local_steps, struct net_buf_simple *peer_steps,
			   enum bt_conn_le_cs_role role, cs_de_report_t *p_report);

/* Takes partially populated report and calculates distance estimates and quality. */
cs_de_quality_t cs_de_calc(cs_de_report_t *p_report);

/**
 * @}
 */

#endif /* CS_DE_H__ */
```
